// SPDX-License-Identifier: GPL-2.0-only OR MIT
/*
 * https://beagleboard.org/ai-64
 *
 * Copyright (C) 2024 Texas Instruments Incorporated - https://www.ti.com/
 * Copyright (C) 2024 Robert Nelson, BeagleBoard.org Foundation
 */

#include <dt-bindings/gpio/gpio.h>

&main_pmx0 {
	P8_03_gpio: P8-03-gpio-pins {
		pinctrl-single,pins = <
			J721E_IOPAD(0x54, PIN_INPUT, 7) /* (AH21) PRG1_PRU0_GPO19.GPIO0_20 */
		>;
	};

	P8_03_gpio_pu: P8-03-gpio-pu-pins {
		pinctrl-single,pins = <
			J721E_IOPAD(0x54, PIN_INPUT_PULLUP, 7) /* (AH21) PRG1_PRU0_GPO19.GPIO0_20 */
		>;
	};

	P8_03_gpio_pd: P8-03-gpio-pd-pins {
		pinctrl-single,pins = <
			J721E_IOPAD(0x54, PIN_INPUT_PULLDOWN, 7) /* (AH21) PRG1_PRU0_GPO19.GPIO0_20 */
		>;
	};

	P8_03_audio: P8-03-audio-pins {
		pinctrl-single,pins = <
			J721E_IOPAD(0x54, PIN_INPUT, 12) /* (AH21) PRG1_PRU0_GPO19.MCASP4_AFSX */
		>;
	};

	P8_04_gpio: P8-04-gpio-pins {
		pinctrl-single,pins = <
			J721E_IOPAD(0xC4, PIN_INPUT, 7) /* (AC29) PRG0_PRU0_GPO5.GPIO0_48 */
		>;
	};

	P8_04_gpio_pu: P8-04-gpio-pu-pins {
		pinctrl-single,pins = <
			J721E_IOPAD(0xC4, PIN_INPUT_PULLUP, 7) /* (AC29) PRG0_PRU0_GPO5.GPIO0_48 */
		>;
	};

	P8_04_gpio_pd: P8-04-gpio-pd-pins {
		pinctrl-single,pins = <
			J721E_IOPAD(0xC4, PIN_INPUT_PULLDOWN, 7) /* (AC29) PRG0_PRU0_GPO5.GPIO0_48 */
		>;
	};

	P8_04_audio: P8-04-audio-pins {
		pinctrl-single,pins = <
			J721E_IOPAD(0xC4, PIN_INPUT, 12) /* (AC29) PRG0_PRU0_GPO5.MCASP0_AXR3 */
		>;
	};

	P8_05_gpio: P8-05-gpio-pins {
		pinctrl-single,pins = <
			J721E_IOPAD(0x88, PIN_INPUT, 7) /* (AH25) PRG1_PRU1_GPO12.GPIO0_33 */
		>;
	};

	P8_05_gpio_pu: P8-05-gpio-pu-pins {
		pinctrl-single,pins = <
			J721E_IOPAD(0x88, PIN_INPUT_PULLUP, 7) /* (AH25) PRG1_PRU1_GPO12.GPIO0_33 */
		>;
	};

	P8_05_gpio_pd: P8-05-gpio-pd-pins {
		pinctrl-single,pins = <
			J721E_IOPAD(0x88, PIN_INPUT_PULLDOWN, 7) /* (AH25) PRG1_PRU1_GPO12.GPIO0_33 */
		>;
	};

	P8_05_audio: P8-05-audio-pins {
		pinctrl-single,pins = <
			J721E_IOPAD(0x88, PIN_INPUT, 12) /* (AH25) PRG1_PRU1_GPO12.MCASP9_AFSX */
		>;
	};

	P8_06_gpio: P8-06-gpio-pins {
		pinctrl-single,pins = <
			J721E_IOPAD(0x8C, PIN_INPUT, 7) /* (AG25) PRG1_PRU1_GPO13.GPIO0_34 */
		>;
	};

	P8_06_gpio_pu: P8-06-gpio-pu-pins {
		pinctrl-single,pins = <
			J721E_IOPAD(0x8C, PIN_INPUT_PULLUP, 7) /* (AG25) PRG1_PRU1_GPO13.GPIO0_34 */
		>;
	};

	P8_06_gpio_pd: P8-06-gpio-pd-pins {
		pinctrl-single,pins = <
			J721E_IOPAD(0x8C, PIN_INPUT_PULLDOWN, 7) /* (AG25) PRG1_PRU1_GPO13.GPIO0_34 */
		>;
	};

	P8_06_audio: P8-06-audio-pins {
		pinctrl-single,pins = <
			J721E_IOPAD(0x8C, PIN_INPUT, 12) /* (AG25) PRG1_PRU1_GPO13.MCASP9_AXR0 */
		>;
	};

	P8_06_audio: P8-06-audio-pins {
		pinctrl-single,pins = <
			J721E_IOPAD(0x8C, PIN_INPUT, 13) /* (AG25) PRG1_PRU1_GPO13.MCASP4_ACLKR */
		>;
	};

	P8_07_gpio: P8-07-gpio-pins {
		pinctrl-single,pins = <
			J721E_IOPAD(0x3C, PIN_INPUT, 7) /* (AD24) PRG1_PRU0_GPO14.GPIO0_15 */
		>;
	};

	P8_07_gpio_pu: P8-07-gpio-pu-pins {
		pinctrl-single,pins = <
			J721E_IOPAD(0x3C, PIN_INPUT_PULLUP, 7) /* (AD24) PRG1_PRU0_GPO14.GPIO0_15 */
		>;
	};

	P8_07_gpio_pd: P8-07-gpio-pd-pins {
		pinctrl-single,pins = <
			J721E_IOPAD(0x3C, PIN_INPUT_PULLDOWN, 7) /* (AD24) PRG1_PRU0_GPO14.GPIO0_15 */
		>;
	};

	P8_07_audio: P8-07-audio-pins {
		pinctrl-single,pins = <
			J721E_IOPAD(0x3C, PIN_INPUT, 12) /* (AD24) PRG1_PRU0_GPO14.MCASP7_AXR1 */
		>;
	};

	P8_08_gpio: P8-08-gpio-pins {
		pinctrl-single,pins = <
			J721E_IOPAD(0x38, PIN_INPUT, 7) /* (AG24) PRG1_PRU0_GPO13.GPIO0_14 */
		>;
	};

	P8_08_gpio_pu: P8-08-gpio-pu-pins {
		pinctrl-single,pins = <
			J721E_IOPAD(0x38, PIN_INPUT_PULLUP, 7) /* (AG24) PRG1_PRU0_GPO13.GPIO0_14 */
		>;
	};

	P8_08_gpio_pd: P8-08-gpio-pd-pins {
		pinctrl-single,pins = <
			J721E_IOPAD(0x38, PIN_INPUT_PULLDOWN, 7) /* (AG24) PRG1_PRU0_GPO13.GPIO0_14 */
		>;
	};

	P8_08_audio: P8-08-audio-pins {
		pinctrl-single,pins = <
			J721E_IOPAD(0x38, PIN_INPUT, 12) /* (AG24) PRG1_PRU0_GPO13.MCASP7_AXR0 */
		>;
	};

	P8_09_gpio: P8-09-gpio-pins {
		pinctrl-single,pins = <
			J721E_IOPAD(0x44, PIN_INPUT, 7) /* (AE24) PRG1_PRU0_GPO16.GPIO0_17 */
		>;
	};

	P8_09_gpio_pu: P8-09-gpio-pu-pins {
		pinctrl-single,pins = <
			J721E_IOPAD(0x44, PIN_INPUT_PULLUP, 7) /* (AE24) PRG1_PRU0_GPO16.GPIO0_17 */
		>;
	};

	P8_09_gpio_pd: P8-09-gpio-pd-pins {
		pinctrl-single,pins = <
			J721E_IOPAD(0x44, PIN_INPUT_PULLDOWN, 7) /* (AE24) PRG1_PRU0_GPO16.GPIO0_17 */
		>;
	};

	P8_09_audio: P8-09-audio-pins {
		pinctrl-single,pins = <
			J721E_IOPAD(0x44, PIN_INPUT, 12) /* (AE24) PRG1_PRU0_GPO16.MCASP7_AXR3 */
		>;
	};

	P8_09_audio: P8-09-audio-pins {
		pinctrl-single,pins = <
			J721E_IOPAD(0x44, PIN_INPUT, 13) /* (AE24) PRG1_PRU0_GPO16.MCASP7_AFSR */
		>;
	};

	P8_10_gpio: P8-10-gpio-pins {
		pinctrl-single,pins = <
			J721E_IOPAD(0x40, PIN_INPUT, 7) /* (AC24) PRG1_PRU0_GPO15.GPIO0_16 */
		>;
	};

	P8_10_gpio_pu: P8-10-gpio-pu-pins {
		pinctrl-single,pins = <
			J721E_IOPAD(0x40, PIN_INPUT_PULLUP, 7) /* (AC24) PRG1_PRU0_GPO15.GPIO0_16 */
		>;
	};

	P8_10_gpio_pd: P8-10-gpio-pd-pins {
		pinctrl-single,pins = <
			J721E_IOPAD(0x40, PIN_INPUT_PULLDOWN, 7) /* (AC24) PRG1_PRU0_GPO15.GPIO0_16 */
		>;
	};

	P8_10_audio: P8-10-audio-pins {
		pinctrl-single,pins = <
			J721E_IOPAD(0x40, PIN_INPUT, 12) /* (AC24) PRG1_PRU0_GPO15.MCASP7_AXR2 */
		>;
	};

	P8_10_audio: P8-10-audio-pins {
		pinctrl-single,pins = <
			J721E_IOPAD(0x40, PIN_INPUT, 13) /* (AC24) PRG1_PRU0_GPO15.MCASP7_ACLKR */
		>;
	};

	P8_11_gpio: P8-11-gpio-pins {
		pinctrl-single,pins = <
			J721E_IOPAD(0xF4, PIN_INPUT, 7) /* (AB24) PRG0_PRU0_GPO17.GPIO0_60 */
		>;
	};

	P8_11_gpio_pu: P8-11-gpio-pu-pins {
		pinctrl-single,pins = <
			J721E_IOPAD(0xF4, PIN_INPUT_PULLUP, 7) /* (AB24) PRG0_PRU0_GPO17.GPIO0_60 */
		>;
	};

	P8_11_gpio_pd: P8-11-gpio-pd-pins {
		pinctrl-single,pins = <
			J721E_IOPAD(0xF4, PIN_INPUT_PULLDOWN, 7) /* (AB24) PRG0_PRU0_GPO17.GPIO0_60 */
		>;
	};

	P8_11_audio: P8-11-audio-pins {
		pinctrl-single,pins = <
			J721E_IOPAD(0xF4, PIN_INPUT, 12) /* (AB24) PRG0_PRU0_GPO17.MCASP0_AXR13 */
		>;
	};

	P8_12_gpio: P8-12-gpio-pins {
		pinctrl-single,pins = <
			J721E_IOPAD(0xF0, PIN_INPUT, 7) /* (AH28) PRG0_PRU0_GPO16.GPIO0_59 */
		>;
	};

	P8_12_gpio_pu: P8-12-gpio-pu-pins {
		pinctrl-single,pins = <
			J721E_IOPAD(0xF0, PIN_INPUT_PULLUP, 7) /* (AH28) PRG0_PRU0_GPO16.GPIO0_59 */
		>;
	};

	P8_12_gpio_pd: P8-12-gpio-pd-pins {
		pinctrl-single,pins = <
			J721E_IOPAD(0xF0, PIN_INPUT_PULLDOWN, 7) /* (AH28) PRG0_PRU0_GPO16.GPIO0_59 */
		>;
	};

	P8_12_audio: P8-12-audio-pins {
		pinctrl-single,pins = <
			J721E_IOPAD(0xF0, PIN_INPUT, 12) /* (AH28) PRG0_PRU0_GPO16.MCASP0_AXR12 */
		>;
	};

	P8_13_i2c: P8-13-i2c-pins {
		pinctrl-single,pins = <
			J721E_IOPAD(0x168, PIN_INPUT_PULLUP, 2) /* (V27) RGMII5_TD1.I2C3_SCL */
		>;
	};

	P8_13_pwm: P8-13-pwm-pins {
		pinctrl-single,pins = <
			J721E_IOPAD(0x168, PIN_OUTPUT, 6) /* (V27) RGMII5_TD1.EHRPWM0_B */
		>;
	};

	P8_13_gpio: P8-13-gpio-pins {
		pinctrl-single,pins = <
			J721E_IOPAD(0x168, PIN_INPUT, 7) /* (V27) RGMII5_TD1.GPIO0_89 */
		>;
	};

	P8_13_gpio_pu: P8-13-gpio-pu-pins {
		pinctrl-single,pins = <
			J721E_IOPAD(0x168, PIN_INPUT_PULLUP, 7) /* (V27) RGMII5_TD1.GPIO0_89 */
		>;
	};

	P8_13_gpio_pd: P8-13-gpio-pd-pins {
		pinctrl-single,pins = <
			J721E_IOPAD(0x168, PIN_INPUT_PULLDOWN, 7) /* (V27) RGMII5_TD1.GPIO0_89 */
		>;
	};

	P8_13_audio: P8-13-audio-pins {
		pinctrl-single,pins = <
			J721E_IOPAD(0x168, PIN_INPUT, 12) /* (V27) RGMII5_TD1.MCASP11_ACLKX */
		>;
	};

	P8_14_gpio: P8-14-gpio-pins {
		pinctrl-single,pins = <
			J721E_IOPAD(0x130, PIN_INPUT, 7) /* (AF27) PRG0_PRU1_GPO12.GPIO0_75 */
		>;
	};

	P8_14_gpio_pu: P8-14-gpio-pu-pins {
		pinctrl-single,pins = <
			J721E_IOPAD(0x130, PIN_INPUT_PULLUP, 7) /* (AF27) PRG0_PRU1_GPO12.GPIO0_75 */
		>;
	};

	P8_14_gpio_pd: P8-14-gpio-pd-pins {
		pinctrl-single,pins = <
			J721E_IOPAD(0x130, PIN_INPUT_PULLDOWN, 7) /* (AF27) PRG0_PRU1_GPO12.GPIO0_75 */
		>;
	};

	P8_14_audio: P8-14-audio-pins {
		pinctrl-single,pins = <
			J721E_IOPAD(0x130, PIN_INPUT, 12) /* (AF27) PRG0_PRU1_GPO12.MCASP1_AXR8 */
		>;
	};

	P8_15_gpio: P8-15-gpio-pins {
		pinctrl-single,pins = <
			J721E_IOPAD(0xF8, PIN_INPUT, 7) /* (AB29) PRG0_PRU0_GPO18.GPIO0_61 */
		>;
	};

	P8_15_gpio_pu: P8-15-gpio-pu-pins {
		pinctrl-single,pins = <
			J721E_IOPAD(0xF8, PIN_INPUT_PULLUP, 7) /* (AB29) PRG0_PRU0_GPO18.GPIO0_61 */
		>;
	};

	P8_15_gpio_pd: P8-15-gpio-pd-pins {
		pinctrl-single,pins = <
			J721E_IOPAD(0xF8, PIN_INPUT_PULLDOWN, 7) /* (AB29) PRG0_PRU0_GPO18.GPIO0_61 */
		>;
	};

	P8_15_audio: P8-15-audio-pins {
		pinctrl-single,pins = <
			J721E_IOPAD(0xF8, PIN_INPUT, 12) /* (AB29) PRG0_PRU0_GPO18.MCASP0_AXR14 */
		>;
	};

	P8_16_gpio: P8-16-gpio-pins {
		pinctrl-single,pins = <
			J721E_IOPAD(0xFC, PIN_INPUT, 7) /* (AB28) PRG0_PRU0_GPO19.GPIO0_62 */
		>;
	};

	P8_16_gpio_pu: P8-16-gpio-pu-pins {
		pinctrl-single,pins = <
			J721E_IOPAD(0xFC, PIN_INPUT_PULLUP, 7) /* (AB28) PRG0_PRU0_GPO19.GPIO0_62 */
		>;
	};

	P8_16_gpio_pd: P8-16-gpio-pd-pins {
		pinctrl-single,pins = <
			J721E_IOPAD(0xFC, PIN_INPUT_PULLDOWN, 7) /* (AB28) PRG0_PRU0_GPO19.GPIO0_62 */
		>;
	};

	P8_16_audio: P8-16-audio-pins {
		pinctrl-single,pins = <
			J721E_IOPAD(0xFC, PIN_INPUT, 12) /* (AB28) PRG0_PRU0_GPO19.MCASP0_AXR15 */
		>;
	};

	P8_17_gpio: P8-17-gpio-pins {
		pinctrl-single,pins = <
			J721E_IOPAD(0xC, PIN_INPUT, 7) /* (AF22) PRG1_PRU0_GPO2.GPIO0_3 */
		>;
	};

	P8_17_gpio_pu: P8-17-gpio-pu-pins {
		pinctrl-single,pins = <
			J721E_IOPAD(0xC, PIN_INPUT_PULLUP, 7) /* (AF22) PRG1_PRU0_GPO2.GPIO0_3 */
		>;
	};

	P8_17_gpio_pd: P8-17-gpio-pd-pins {
		pinctrl-single,pins = <
			J721E_IOPAD(0xC, PIN_INPUT_PULLDOWN, 7) /* (AF22) PRG1_PRU0_GPO2.GPIO0_3 */
		>;
	};

	P8_17_audio: P8-17-audio-pins {
		pinctrl-single,pins = <
			J721E_IOPAD(0xC, PIN_INPUT, 12) /* (AF22) PRG1_PRU0_GPO2.MCASP6_AXR0 */
		>;
	};

	P8_17_uart1_rxd: P8-17-uart1-rxd-pins {
		pinctrl-single,pins = <
			J721E_IOPAD(0xC, PIN_INPUT, 14) /* (AF22) PRG1_PRU0_GPO2.UART1_RXD */
		>;
	};

	P8_18_gpio: P8-18-gpio-pins {
		pinctrl-single,pins = <
			J721E_IOPAD(0x10, PIN_INPUT, 7) /* (AJ23) PRG1_PRU0_GPO3.GPIO0_4 */
		>;
	};

	P8_18_gpio_pu: P8-18-gpio-pu-pins {
		pinctrl-single,pins = <
			J721E_IOPAD(0x10, PIN_INPUT_PULLUP, 7) /* (AJ23) PRG1_PRU0_GPO3.GPIO0_4 */
		>;
	};

	P8_18_gpio_pd: P8-18-gpio-pd-pins {
		pinctrl-single,pins = <
			J721E_IOPAD(0x10, PIN_INPUT_PULLDOWN, 7) /* (AJ23) PRG1_PRU0_GPO3.GPIO0_4 */
		>;
	};

	P8_18_audio: P8-18-audio-pins {
		pinctrl-single,pins = <
			J721E_IOPAD(0x10, PIN_INPUT, 12) /* (AJ23) PRG1_PRU0_GPO3.MCASP6_AXR1 */
		>;
	};

	P8_18_uart1_txd: P8-18-uart1-txd-pins {
		pinctrl-single,pins = <
			J721E_IOPAD(0x10, PIN_OUTPUT, 14) /* (AJ23) PRG1_PRU0_GPO3.UART1_TXD */
		>;
	};

	P8_19_uart3_txd: P8-19-uart3-txd-pins {
		pinctrl-single,pins = <
			J721E_IOPAD(0x164, PIN_OUTPUT, 1) /* (V29) RGMII5_TD2.UART3_TXD */
		>;
	};

	P8_19_pwm: P8-19-pwm-pins {
		pinctrl-single,pins = <
			J721E_IOPAD(0x164, PIN_OUTPUT, 6) /* (V29) RGMII5_TD2.EHRPWM0_A */
		>;
	};

	P8_19_gpio: P8-19-gpio-pins {
		pinctrl-single,pins = <
			J721E_IOPAD(0x164, PIN_INPUT, 7) /* (V29) RGMII5_TD2.GPIO0_88 */
		>;
	};

	P8_19_gpio_pu: P8-19-gpio-pu-pins {
		pinctrl-single,pins = <
			J721E_IOPAD(0x164, PIN_INPUT_PULLUP, 7) /* (V29) RGMII5_TD2.GPIO0_88 */
		>;
	};

	P8_19_gpio_pd: P8-19-gpio-pd-pins {
		pinctrl-single,pins = <
			J721E_IOPAD(0x164, PIN_INPUT_PULLDOWN, 7) /* (V29) RGMII5_TD2.GPIO0_88 */
		>;
	};

	P8_19_audio: P8-19-audio-pins {
		pinctrl-single,pins = <
			J721E_IOPAD(0x164, PIN_INPUT, 12) /* (V29) RGMII5_TD2.MCASP10_AXR1 */
		>;
	};

	P8_20_gpio: P8-20-gpio-pins {
		pinctrl-single,pins = <
			J721E_IOPAD(0x134, PIN_INPUT, 7) /* (AF26) PRG0_PRU1_GPO13.GPIO0_76 */
		>;
	};

	P8_20_gpio_pu: P8-20-gpio-pu-pins {
		pinctrl-single,pins = <
			J721E_IOPAD(0x134, PIN_INPUT_PULLUP, 7) /* (AF26) PRG0_PRU1_GPO13.GPIO0_76 */
		>;
	};

	P8_20_gpio_pd: P8-20-gpio-pd-pins {
		pinctrl-single,pins = <
			J721E_IOPAD(0x134, PIN_INPUT_PULLDOWN, 7) /* (AF26) PRG0_PRU1_GPO13.GPIO0_76 */
		>;
	};

	P8_20_audio: P8-20-audio-pins {
		pinctrl-single,pins = <
			J721E_IOPAD(0x134, PIN_INPUT, 12) /* (AF26) PRG0_PRU1_GPO13.MCASP1_AXR9 */
		>;
	};

	P8_21_gpio: P8-21-gpio-pins {
		pinctrl-single,pins = <
			J721E_IOPAD(0x7C, PIN_INPUT, 7) /* (AF21) PRG1_PRU1_GPO9.GPIO0_30 */
		>;
	};

	P8_21_gpio_pu: P8-21-gpio-pu-pins {
		pinctrl-single,pins = <
			J721E_IOPAD(0x7C, PIN_INPUT_PULLUP, 7) /* (AF21) PRG1_PRU1_GPO9.GPIO0_30 */
		>;
	};

	P8_21_gpio_pd: P8-21-gpio-pd-pins {
		pinctrl-single,pins = <
			J721E_IOPAD(0x7C, PIN_INPUT_PULLDOWN, 7) /* (AF21) PRG1_PRU1_GPO9.GPIO0_30 */
		>;
	};

	P8_21_audio: P8-21-audio-pins {
		pinctrl-single,pins = <
			J721E_IOPAD(0x7C, PIN_INPUT, 12) /* (AF21) PRG1_PRU1_GPO9.MCASP4_AXR3 */
		>;
	};

	P8_22_gpio: P8-22-gpio-pins {
		pinctrl-single,pins = <
			J721E_IOPAD(0x14, PIN_INPUT, 7) /* (AH23) PRG1_PRU0_GPO4.GPIO0_5 */
		>;
	};

	P8_22_gpio_pu: P8-22-gpio-pu-pins {
		pinctrl-single,pins = <
			J721E_IOPAD(0x14, PIN_INPUT_PULLUP, 7) /* (AH23) PRG1_PRU0_GPO4.GPIO0_5 */
		>;
	};

	P8_22_gpio_pd: P8-22-gpio-pd-pins {
		pinctrl-single,pins = <
			J721E_IOPAD(0x14, PIN_INPUT_PULLDOWN, 7) /* (AH23) PRG1_PRU0_GPO4.GPIO0_5 */
		>;
	};

	P8_22_audio: P8-22-audio-pins {
		pinctrl-single,pins = <
			J721E_IOPAD(0x14, PIN_INPUT, 12) /* (AH23) PRG1_PRU0_GPO4.MCASP6_AXR2 */
		>;
	};

	P8_22_audio: P8-22-audio-pins {
		pinctrl-single,pins = <
			J721E_IOPAD(0x14, PIN_INPUT, 13) /* (AH23) PRG1_PRU0_GPO4.MCASP6_ACLKR */
		>;
	};

	P8_22_uart2_rxd: P8-22-uart2-rxd-pins {
		pinctrl-single,pins = <
			J721E_IOPAD(0x14, PIN_INPUT, 14) /* (AH23) PRG1_PRU0_GPO4.UART2_RXD */
		>;
	};

	P8_23_gpio: P8-23-gpio-pins {
		pinctrl-single,pins = <
			J721E_IOPAD(0x80, PIN_INPUT, 7) /* (AB23) PRG1_PRU1_GPO10.GPIO0_31 */
		>;
	};

	P8_23_gpio_pu: P8-23-gpio-pu-pins {
		pinctrl-single,pins = <
			J721E_IOPAD(0x80, PIN_INPUT_PULLUP, 7) /* (AB23) PRG1_PRU1_GPO10.GPIO0_31 */
		>;
	};

	P8_23_gpio_pd: P8-23-gpio-pd-pins {
		pinctrl-single,pins = <
			J721E_IOPAD(0x80, PIN_INPUT_PULLDOWN, 7) /* (AB23) PRG1_PRU1_GPO10.GPIO0_31 */
		>;
	};

	P8_23_audio: P8-23-audio-pins {
		pinctrl-single,pins = <
			J721E_IOPAD(0x80, PIN_INPUT, 12) /* (AB23) PRG1_PRU1_GPO10.MCASP5_ACLKX */
		>;
	};

	P8_24_gpio: P8-24-gpio-pins {
		pinctrl-single,pins = <
			J721E_IOPAD(0x18, PIN_INPUT, 7) /* (AD20) PRG1_PRU0_GPO5.GPIO0_6 */
		>;
	};

	P8_24_gpio_pu: P8-24-gpio-pu-pins {
		pinctrl-single,pins = <
			J721E_IOPAD(0x18, PIN_INPUT_PULLUP, 7) /* (AD20) PRG1_PRU0_GPO5.GPIO0_6 */
		>;
	};

	P8_24_gpio_pd: P8-24-gpio-pd-pins {
		pinctrl-single,pins = <
			J721E_IOPAD(0x18, PIN_INPUT_PULLDOWN, 7) /* (AD20) PRG1_PRU0_GPO5.GPIO0_6 */
		>;
	};

	P8_24_audio: P8-24-audio-pins {
		pinctrl-single,pins = <
			J721E_IOPAD(0x18, PIN_INPUT, 12) /* (AD20) PRG1_PRU0_GPO5.MCASP3_AXR0 */
		>;
	};

	P8_25_gpio: P8-25-gpio-pins {
		pinctrl-single,pins = <
			J721E_IOPAD(0x90, PIN_INPUT, 7) /* (AH26) PRG1_PRU1_GPO14.GPIO0_35 */
		>;
	};

	P8_25_gpio_pu: P8-25-gpio-pu-pins {
		pinctrl-single,pins = <
			J721E_IOPAD(0x90, PIN_INPUT_PULLUP, 7) /* (AH26) PRG1_PRU1_GPO14.GPIO0_35 */
		>;
	};

	P8_25_gpio_pd: P8-25-gpio-pd-pins {
		pinctrl-single,pins = <
			J721E_IOPAD(0x90, PIN_INPUT_PULLDOWN, 7) /* (AH26) PRG1_PRU1_GPO14.GPIO0_35 */
		>;
	};

	P8_25_audio: P8-25-audio-pins {
		pinctrl-single,pins = <
			J721E_IOPAD(0x90, PIN_INPUT, 12) /* (AH26) PRG1_PRU1_GPO14.MCASP9_AXR1 */
		>;
	};

	P8_25_audio: P8-25-audio-pins {
		pinctrl-single,pins = <
			J721E_IOPAD(0x90, PIN_INPUT, 13) /* (AH26) PRG1_PRU1_GPO14.MCASP4_AFSR */
		>;
	};

	P8_26_gpio: P8-26-gpio-pins {
		pinctrl-single,pins = <
			J721E_IOPAD(0xD0, PIN_INPUT, 7) /* (AC27) PRG0_PRU0_GPO8.GPIO0_51 */
		>;
	};

	P8_26_gpio_pu: P8-26-gpio-pu-pins {
		pinctrl-single,pins = <
			J721E_IOPAD(0xD0, PIN_INPUT_PULLUP, 7) /* (AC27) PRG0_PRU0_GPO8.GPIO0_51 */
		>;
	};

	P8_26_gpio_pd: P8-26-gpio-pd-pins {
		pinctrl-single,pins = <
			J721E_IOPAD(0xD0, PIN_INPUT_PULLDOWN, 7) /* (AC27) PRG0_PRU0_GPO8.GPIO0_51 */
		>;
	};

	P8_26_audio: P8-26-audio-pins {
		pinctrl-single,pins = <
			J721E_IOPAD(0xD0, PIN_INPUT, 12) /* (AC27) PRG0_PRU0_GPO8.MCASP0_AXR6 */
		>;
	};

	P8_26_uart6_rxd: P8-26-uart6-rxd-pins {
		pinctrl-single,pins = <
			J721E_IOPAD(0xD0, PIN_INPUT, 14) /* (AC27) PRG0_PRU0_GPO8.UART6_RXD */
		>;
	};

	P8_27_gpio: P8-27-gpio-pins {
		pinctrl-single,pins = <
			J721E_IOPAD(0x120, PIN_INPUT, 7) /* (AA28) PRG0_PRU1_GPO8.GPIO0_71 */
		>;
	};

	P8_27_gpio_pu: P8-27-gpio-pu-pins {
		pinctrl-single,pins = <
			J721E_IOPAD(0x120, PIN_INPUT_PULLUP, 7) /* (AA28) PRG0_PRU1_GPO8.GPIO0_71 */
		>;
	};

	P8_27_gpio_pd: P8-27-gpio-pd-pins {
		pinctrl-single,pins = <
			J721E_IOPAD(0x120, PIN_INPUT_PULLDOWN, 7) /* (AA28) PRG0_PRU1_GPO8.GPIO0_71 */
		>;
	};

	P8_27_audio: P8-27-audio-pins {
		pinctrl-single,pins = <
			J721E_IOPAD(0x120, PIN_INPUT, 12) /* (AA28) PRG0_PRU1_GPO8.MCASP1_AFSX */
		>;
	};

	P8_28_gpio: P8-28-gpio-pins {
		pinctrl-single,pins = <
			J721E_IOPAD(0x124, PIN_INPUT, 7) /* (Y24) PRG0_PRU1_GPO9.GPIO0_72 */
		>;
	};

	P8_28_gpio_pu: P8-28-gpio-pu-pins {
		pinctrl-single,pins = <
			J721E_IOPAD(0x124, PIN_INPUT_PULLUP, 7) /* (Y24) PRG0_PRU1_GPO9.GPIO0_72 */
		>;
	};

	P8_28_gpio_pd: P8-28-gpio-pd-pins {
		pinctrl-single,pins = <
			J721E_IOPAD(0x124, PIN_INPUT_PULLDOWN, 7) /* (Y24) PRG0_PRU1_GPO9.GPIO0_72 */
		>;
	};

	P8_28_audio: P8-28-audio-pins {
		pinctrl-single,pins = <
			J721E_IOPAD(0x124, PIN_INPUT, 12) /* (Y24) PRG0_PRU1_GPO9.MCASP1_AXR5 */
		>;
	};

	P8_28_uart8_rxd: P8-28-uart8-rxd-pins {
		pinctrl-single,pins = <
			J721E_IOPAD(0x124, PIN_INPUT, 14) /* (Y24) PRG0_PRU1_GPO9.UART8_RXD */
		>;
	};

	P8_29_gpio: P8-29-gpio-pins {
		pinctrl-single,pins = <
			J721E_IOPAD(0x128, PIN_INPUT, 7) /* (AA25) PRG0_PRU1_GPO10.GPIO0_73 */
		>;
	};

	P8_29_gpio_pu: P8-29-gpio-pu-pins {
		pinctrl-single,pins = <
			J721E_IOPAD(0x128, PIN_INPUT_PULLUP, 7) /* (AA25) PRG0_PRU1_GPO10.GPIO0_73 */
		>;
	};

	P8_29_gpio_pd: P8-29-gpio-pd-pins {
		pinctrl-single,pins = <
			J721E_IOPAD(0x128, PIN_INPUT_PULLDOWN, 7) /* (AA25) PRG0_PRU1_GPO10.GPIO0_73 */
		>;
	};

	P8_29_audio: P8-29-audio-pins {
		pinctrl-single,pins = <
			J721E_IOPAD(0x128, PIN_INPUT, 12) /* (AA25) PRG0_PRU1_GPO10.MCASP1_AXR6 */
		>;
	};

	P8_29_uart8_txd: P8-29-uart8-txd-pins {
		pinctrl-single,pins = <
			J721E_IOPAD(0x128, PIN_OUTPUT, 14) /* (AA25) PRG0_PRU1_GPO10.UART8_TXD */
		>;
	};

	P8_30_gpio: P8-30-gpio-pins {
		pinctrl-single,pins = <
			J721E_IOPAD(0x12C, PIN_INPUT, 7) /* (AG26) PRG0_PRU1_GPO11.GPIO0_74 */
		>;
	};

	P8_30_gpio_pu: P8-30-gpio-pu-pins {
		pinctrl-single,pins = <
			J721E_IOPAD(0x12C, PIN_INPUT_PULLUP, 7) /* (AG26) PRG0_PRU1_GPO11.GPIO0_74 */
		>;
	};

	P8_30_gpio_pd: P8-30-gpio-pd-pins {
		pinctrl-single,pins = <
			J721E_IOPAD(0x12C, PIN_INPUT_PULLDOWN, 7) /* (AG26) PRG0_PRU1_GPO11.GPIO0_74 */
		>;
	};

	P8_30_audio: P8-30-audio-pins {
		pinctrl-single,pins = <
			J721E_IOPAD(0x12C, PIN_INPUT, 12) /* (AG26) PRG0_PRU1_GPO11.MCASP1_AXR7 */
		>;
	};

	P8_31A_gpio: P8-31A-gpio-pins {
		pinctrl-single,pins = <
			J721E_IOPAD(0x84, PIN_INPUT, 7) /* (AJ25) PRG1_PRU1_GPO11.GPIO0_32 */
		>;
	};

	P8_31A_gpio_pu: P8-31A-gpio-pu-pins {
		pinctrl-single,pins = <
			J721E_IOPAD(0x84, PIN_INPUT_PULLUP, 7) /* (AJ25) PRG1_PRU1_GPO11.GPIO0_32 */
		>;
	};

	P8_31A_gpio_pd: P8-31A-gpio-pd-pins {
		pinctrl-single,pins = <
			J721E_IOPAD(0x84, PIN_INPUT_PULLDOWN, 7) /* (AJ25) PRG1_PRU1_GPO11.GPIO0_32 */
		>;
	};

	P8_31A_eqep: P8-31A-eqep-pins {
		pinctrl-single,pins = <
			J721E_IOPAD(0x84, PIN_INPUT, 9) /* (AJ25) PRG1_PRU1_GPO11.EQEP1_I */
		>;
	};

	P8_31A_audio: P8-31A-audio-pins {
		pinctrl-single,pins = <
			J721E_IOPAD(0x84, PIN_INPUT, 12) /* (AJ25) PRG1_PRU1_GPO11.MCASP9_ACLKX */
		>;
	};

	P8_31B_gpio: P8-31B-gpio-pins {
		pinctrl-single,pins = <
			J721E_IOPAD(0x100, PIN_INPUT, 7) /* (AE29) PRG0_PRU1_GPO0.GPIO0_63 */
		>;
	};

	P8_31B_gpio_pu: P8-31B-gpio-pu-pins {
		pinctrl-single,pins = <
			J721E_IOPAD(0x100, PIN_INPUT_PULLUP, 7) /* (AE29) PRG0_PRU1_GPO0.GPIO0_63 */
		>;
	};

	P8_31B_gpio_pd: P8-31B-gpio-pd-pins {
		pinctrl-single,pins = <
			J721E_IOPAD(0x100, PIN_INPUT_PULLDOWN, 7) /* (AE29) PRG0_PRU1_GPO0.GPIO0_63 */
		>;
	};

	P8_31B_audio: P8-31B-audio-pins {
		pinctrl-single,pins = <
			J721E_IOPAD(0x100, PIN_INPUT, 12) /* (AE29) PRG0_PRU1_GPO0.MCASP1_AXR0 */
		>;
	};

	P8_31B_uart5_rxd: P8-31B-uart5-rxd-pins {
		pinctrl-single,pins = <
			J721E_IOPAD(0x100, PIN_INPUT, 14) /* (AE29) PRG0_PRU1_GPO0.UART5_RXD */
		>;
	};

	P8_32A_gpio: P8-32A-gpio-pins {
		pinctrl-single,pins = <
			J721E_IOPAD(0x6C, PIN_INPUT, 7) /* (AG21) PRG1_PRU1_GPO5.GPIO0_26 */
		>;
	};

	P8_32A_gpio_pu: P8-32A-gpio-pu-pins {
		pinctrl-single,pins = <
			J721E_IOPAD(0x6C, PIN_INPUT_PULLUP, 7) /* (AG21) PRG1_PRU1_GPO5.GPIO0_26 */
		>;
	};

	P8_32A_gpio_pd: P8-32A-gpio-pd-pins {
		pinctrl-single,pins = <
			J721E_IOPAD(0x6C, PIN_INPUT_PULLDOWN, 7) /* (AG21) PRG1_PRU1_GPO5.GPIO0_26 */
		>;
	};

	P8_32A_eqep: P8-32A-eqep-pins {
		pinctrl-single,pins = <
			J721E_IOPAD(0x6C, PIN_INPUT, 9) /* (AG21) PRG1_PRU1_GPO5.EQEP1_S */
		>;
	};

	P8_32A_audio: P8-32A-audio-pins {
		pinctrl-single,pins = <
			J721E_IOPAD(0x6C, PIN_INPUT, 12) /* (AG21) PRG1_PRU1_GPO5.MCASP4_AXR0 */
		>;
	};

	P8_32B_gpio: P8-32B-gpio-pins {
		pinctrl-single,pins = <
			J721E_IOPAD(0x104, PIN_INPUT, 7) /* (AD28) PRG0_PRU1_GPO1.GPIO0_64 */
		>;
	};

	P8_32B_gpio_pu: P8-32B-gpio-pu-pins {
		pinctrl-single,pins = <
			J721E_IOPAD(0x104, PIN_INPUT_PULLUP, 7) /* (AD28) PRG0_PRU1_GPO1.GPIO0_64 */
		>;
	};

	P8_32B_gpio_pd: P8-32B-gpio-pd-pins {
		pinctrl-single,pins = <
			J721E_IOPAD(0x104, PIN_INPUT_PULLDOWN, 7) /* (AD28) PRG0_PRU1_GPO1.GPIO0_64 */
		>;
	};

	P8_32B_audio: P8-32B-audio-pins {
		pinctrl-single,pins = <
			J721E_IOPAD(0x104, PIN_INPUT, 12) /* (AD28) PRG0_PRU1_GPO1.MCASP1_AXR1 */
		>;
	};

	P8_32B_uart5_txd: P8-32B-uart5-txd-pins {
		pinctrl-single,pins = <
			J721E_IOPAD(0x104, PIN_OUTPUT, 14) /* (AD28) PRG0_PRU1_GPO1.UART5_TXD */
		>;
	};

	P8_33A_gpio: P8-33A-gpio-pins {
		pinctrl-single,pins = <
			J721E_IOPAD(0x68, PIN_INPUT, 7) /* (AH24) PRG1_PRU1_GPO4.GPIO0_25 */
		>;
	};

	P8_33A_gpio_pu: P8-33A-gpio-pu-pins {
		pinctrl-single,pins = <
			J721E_IOPAD(0x68, PIN_INPUT_PULLUP, 7) /* (AH24) PRG1_PRU1_GPO4.GPIO0_25 */
		>;
	};

	P8_33A_gpio_pd: P8-33A-gpio-pd-pins {
		pinctrl-single,pins = <
			J721E_IOPAD(0x68, PIN_INPUT_PULLDOWN, 7) /* (AH24) PRG1_PRU1_GPO4.GPIO0_25 */
		>;
	};

	P8_33A_eqep: P8-33A-eqep-pins {
		pinctrl-single,pins = <
			J721E_IOPAD(0x68, PIN_INPUT, 9) /* (AH24) PRG1_PRU1_GPO4.EQEP1_B */
		>;
	};

	P8_33A_audio: P8-33A-audio-pins {
		pinctrl-single,pins = <
			J721E_IOPAD(0x68, PIN_INPUT, 12) /* (AH24) PRG1_PRU1_GPO4.MCASP8_AXR2 */
		>;
	};

	P8_33A_audio: P8-33A-audio-pins {
		pinctrl-single,pins = <
			J721E_IOPAD(0x68, PIN_INPUT, 13) /* (AH24) PRG1_PRU1_GPO4.MCASP8_ACLKR */
		>;
	};

	P8_33B_gpio: P8-33B-gpio-pins {
		pinctrl-single,pins = <
			J721E_IOPAD(0x1C0, PIN_INPUT, 7) /* (AA2) SPI0_CS0.GPIO0_111 */
		>;
	};

	P8_33B_gpio_pu: P8-33B-gpio-pu-pins {
		pinctrl-single,pins = <
			J721E_IOPAD(0x1C0, PIN_INPUT_PULLUP, 7) /* (AA2) SPI0_CS0.GPIO0_111 */
		>;
	};

	P8_33B_gpio_pd: P8-33B-gpio-pd-pins {
		pinctrl-single,pins = <
			J721E_IOPAD(0x1C0, PIN_INPUT_PULLDOWN, 7) /* (AA2) SPI0_CS0.GPIO0_111 */
		>;
	};

	P8_34_gpio: P8-34-gpio-pins {
		pinctrl-single,pins = <
			J721E_IOPAD(0x1C, PIN_INPUT, 7) /* (AD22) PRG1_PRU0_GPO6.GPIO0_7 */
		>;
	};

	P8_34_gpio_pu: P8-34-gpio-pu-pins {
		pinctrl-single,pins = <
			J721E_IOPAD(0x1C, PIN_INPUT_PULLUP, 7) /* (AD22) PRG1_PRU0_GPO6.GPIO0_7 */
		>;
	};

	P8_34_gpio_pd: P8-34-gpio-pd-pins {
		pinctrl-single,pins = <
			J721E_IOPAD(0x1C, PIN_INPUT_PULLDOWN, 7) /* (AD22) PRG1_PRU0_GPO6.GPIO0_7 */
		>;
	};

	P8_34_audio: P8-34-audio-pins {
		pinctrl-single,pins = <
			J721E_IOPAD(0x1C, PIN_INPUT, 12) /* (AD22) PRG1_PRU0_GPO6.MCASP6_AXR3 */
		>;
	};

	P8_34_audio: P8-34-audio-pins {
		pinctrl-single,pins = <
			J721E_IOPAD(0x1C, PIN_INPUT, 13) /* (AD22) PRG1_PRU0_GPO6.MCASP6_AFSR */
		>;
	};

	P8_34_uart2_txd: P8-34-uart2-txd-pins {
		pinctrl-single,pins = <
			J721E_IOPAD(0x1C, PIN_OUTPUT, 14) /* (AD22) PRG1_PRU0_GPO6.UART2_TXD */
		>;
	};

	P8_35A_gpio: P8-35A-gpio-pins {
		pinctrl-single,pins = <
			J721E_IOPAD(0x64, PIN_INPUT, 7) /* (AD23) PRG1_PRU1_GPO3.GPIO0_24 */
		>;
	};

	P8_35A_gpio_pu: P8-35A-gpio-pu-pins {
		pinctrl-single,pins = <
			J721E_IOPAD(0x64, PIN_INPUT_PULLUP, 7) /* (AD23) PRG1_PRU1_GPO3.GPIO0_24 */
		>;
	};

	P8_35A_gpio_pd: P8-35A-gpio-pd-pins {
		pinctrl-single,pins = <
			J721E_IOPAD(0x64, PIN_INPUT_PULLDOWN, 7) /* (AD23) PRG1_PRU1_GPO3.GPIO0_24 */
		>;
	};

	P8_35A_eqep: P8-35A-eqep-pins {
		pinctrl-single,pins = <
			J721E_IOPAD(0x64, PIN_INPUT, 9) /* (AD23) PRG1_PRU1_GPO3.EQEP1_A */
		>;
	};

	P8_35A_audio: P8-35A-audio-pins {
		pinctrl-single,pins = <
			J721E_IOPAD(0x64, PIN_INPUT, 12) /* (AD23) PRG1_PRU1_GPO3.MCASP8_AXR1 */
		>;
	};

	P8_35A_audio: P8-35A-audio-pins {
		pinctrl-single,pins = <
			J721E_IOPAD(0x64, PIN_INPUT, 13) /* (AD23) PRG1_PRU1_GPO3.MCASP3_AFSR */
		>;
	};

	P8_35B_uart5_rxd: P8-35B-uart5-rxd-pins {
		pinctrl-single,pins = <
			J721E_IOPAD(0x1D4, PIN_INPUT, 3) /* (Y3) SPI1_CS0.UART5_RXD */
		>;
	};

	P8_35B_gpio: P8-35B-gpio-pins {
		pinctrl-single,pins = <
			J721E_IOPAD(0x1D4, PIN_INPUT, 7) /* (Y3) SPI1_CS0.GPIO0_116 */
		>;
	};

	P8_35B_gpio_pu: P8-35B-gpio-pu-pins {
		pinctrl-single,pins = <
			J721E_IOPAD(0x1D4, PIN_INPUT_PULLUP, 7) /* (Y3) SPI1_CS0.GPIO0_116 */
		>;
	};

	P8_35B_gpio_pd: P8-35B-gpio-pd-pins {
		pinctrl-single,pins = <
			J721E_IOPAD(0x1D4, PIN_INPUT_PULLDOWN, 7) /* (Y3) SPI1_CS0.GPIO0_116 */
		>;
	};

	P8_36_gpio: P8-36-gpio-pins {
		pinctrl-single,pins = <
			J721E_IOPAD(0x20, PIN_INPUT, 7) /* (AE20) PRG1_PRU0_GPO7.GPIO0_8 */
		>;
	};

	P8_36_gpio_pu: P8-36-gpio-pu-pins {
		pinctrl-single,pins = <
			J721E_IOPAD(0x20, PIN_INPUT_PULLUP, 7) /* (AE20) PRG1_PRU0_GPO7.GPIO0_8 */
		>;
	};

	P8_36_gpio_pd: P8-36-gpio-pd-pins {
		pinctrl-single,pins = <
			J721E_IOPAD(0x20, PIN_INPUT_PULLDOWN, 7) /* (AE20) PRG1_PRU0_GPO7.GPIO0_8 */
		>;
	};

	P8_36_audio: P8-36-audio-pins {
		pinctrl-single,pins = <
			J721E_IOPAD(0x20, PIN_INPUT, 12) /* (AE20) PRG1_PRU0_GPO7.MCASP3_AXR1 */
		>;
	};

	P8_37A_uart5_txd: P8-37A-uart5-txd-pins {
		pinctrl-single,pins = <
			J721E_IOPAD(0x1AC, PIN_OUTPUT, 3) /* (Y27) RGMII6_RD2.UART5_TXD */
		>;
	};

	P8_37A_gpio: P8-37A-gpio-pins {
		pinctrl-single,pins = <
			J721E_IOPAD(0x1AC, PIN_INPUT, 7) /* (Y27) RGMII6_RD2.GPIO0_106 */
		>;
	};

	P8_37A_gpio_pu: P8-37A-gpio-pu-pins {
		pinctrl-single,pins = <
			J721E_IOPAD(0x1AC, PIN_INPUT_PULLUP, 7) /* (Y27) RGMII6_RD2.GPIO0_106 */
		>;
	};

	P8_37A_gpio_pd: P8-37A-gpio-pd-pins {
		pinctrl-single,pins = <
			J721E_IOPAD(0x1AC, PIN_INPUT_PULLDOWN, 7) /* (Y27) RGMII6_RD2.GPIO0_106 */
		>;
	};

	P8_37A_audio: P8-37A-audio-pins {
		pinctrl-single,pins = <
			J721E_IOPAD(0x1AC, PIN_INPUT, 12) /* (Y27) RGMII6_RD2.MCASP11_AXR5 */
		>;
	};

	P8_37B_gpio: P8-37B-gpio-pins {
		pinctrl-single,pins = <
			J721E_IOPAD(0x2C, PIN_INPUT, 7) /* (AD21) PRG1_PRU0_GPO10.GPIO0_11 */
		>;
	};

	P8_37B_gpio_pu: P8-37B-gpio-pu-pins {
		pinctrl-single,pins = <
			J721E_IOPAD(0x2C, PIN_INPUT_PULLUP, 7) /* (AD21) PRG1_PRU0_GPO10.GPIO0_11 */
		>;
	};

	P8_37B_gpio_pd: P8-37B-gpio-pd-pins {
		pinctrl-single,pins = <
			J721E_IOPAD(0x2C, PIN_INPUT_PULLDOWN, 7) /* (AD21) PRG1_PRU0_GPO10.GPIO0_11 */
		>;
	};

	P8_37B_audio: P8-37B-audio-pins {
		pinctrl-single,pins = <
			J721E_IOPAD(0x2C, PIN_INPUT, 12) /* (AD21) PRG1_PRU0_GPO10.MCASP3_AFSX */
		>;
	};

	P8_38A_gpio: P8-38A-gpio-pins {
		pinctrl-single,pins = <
			J721E_IOPAD(0x24, PIN_INPUT, 7) /* (AJ20) PRG1_PRU0_GPO8.GPIO0_9 */
		>;
	};

	P8_38A_gpio_pu: P8-38A-gpio-pu-pins {
		pinctrl-single,pins = <
			J721E_IOPAD(0x24, PIN_INPUT_PULLUP, 7) /* (AJ20) PRG1_PRU0_GPO8.GPIO0_9 */
		>;
	};

	P8_38A_gpio_pd: P8-38A-gpio-pd-pins {
		pinctrl-single,pins = <
			J721E_IOPAD(0x24, PIN_INPUT_PULLDOWN, 7) /* (AJ20) PRG1_PRU0_GPO8.GPIO0_9 */
		>;
	};

	P8_38A_audio: P8-38A-audio-pins {
		pinctrl-single,pins = <
			J721E_IOPAD(0x24, PIN_INPUT, 12) /* (AJ20) PRG1_PRU0_GPO8.MCASP3_AXR2 */
		>;
	};

	P8_38B_uart5_rxd: P8-38B-uart5-rxd-pins {
		pinctrl-single,pins = <
			J721E_IOPAD(0x1A8, PIN_INPUT, 3) /* (Y29) RGMII6_RD3.UART5_RXD */
		>;
	};

	P8_38B_gpio: P8-38B-gpio-pins {
		pinctrl-single,pins = <
			J721E_IOPAD(0x1A8, PIN_INPUT, 7) /* (Y29) RGMII6_RD3.GPIO0_105 */
		>;
	};

	P8_38B_gpio_pu: P8-38B-gpio-pu-pins {
		pinctrl-single,pins = <
			J721E_IOPAD(0x1A8, PIN_INPUT_PULLUP, 7) /* (Y29) RGMII6_RD3.GPIO0_105 */
		>;
	};

	P8_38B_gpio_pd: P8-38B-gpio-pd-pins {
		pinctrl-single,pins = <
			J721E_IOPAD(0x1A8, PIN_INPUT_PULLDOWN, 7) /* (Y29) RGMII6_RD3.GPIO0_105 */
		>;
	};

	P8_38B_audio: P8-38B-audio-pins {
		pinctrl-single,pins = <
			J721E_IOPAD(0x1A8, PIN_INPUT, 12) /* (Y29) RGMII6_RD3.MCASP11_AXR4 */
		>;
	};

	P8_39_gpio: P8-39-gpio-pins {
		pinctrl-single,pins = <
			J721E_IOPAD(0x118, PIN_INPUT, 7) /* (AC26) PRG0_PRU1_GPO6.GPIO0_69 */
		>;
	};

	P8_39_gpio_pu: P8-39-gpio-pu-pins {
		pinctrl-single,pins = <
			J721E_IOPAD(0x118, PIN_INPUT_PULLUP, 7) /* (AC26) PRG0_PRU1_GPO6.GPIO0_69 */
		>;
	};

	P8_39_gpio_pd: P8-39-gpio-pd-pins {
		pinctrl-single,pins = <
			J721E_IOPAD(0x118, PIN_INPUT_PULLDOWN, 7) /* (AC26) PRG0_PRU1_GPO6.GPIO0_69 */
		>;
	};

	P8_39_audio: P8-39-audio-pins {
		pinctrl-single,pins = <
			J721E_IOPAD(0x118, PIN_INPUT, 12) /* (AC26) PRG0_PRU1_GPO6.MCASP1_AXR3 */
		>;
	};

	P8_40_gpio: P8-40-gpio-pins {
		pinctrl-single,pins = <
			J721E_IOPAD(0x11C, PIN_INPUT, 7) /* (AA24) PRG0_PRU1_GPO7.GPIO0_70 */
		>;
	};

	P8_40_gpio_pu: P8-40-gpio-pu-pins {
		pinctrl-single,pins = <
			J721E_IOPAD(0x11C, PIN_INPUT_PULLUP, 7) /* (AA24) PRG0_PRU1_GPO7.GPIO0_70 */
		>;
	};

	P8_40_gpio_pd: P8-40-gpio-pd-pins {
		pinctrl-single,pins = <
			J721E_IOPAD(0x11C, PIN_INPUT_PULLDOWN, 7) /* (AA24) PRG0_PRU1_GPO7.GPIO0_70 */
		>;
	};

	P8_40_audio: P8-40-audio-pins {
		pinctrl-single,pins = <
			J721E_IOPAD(0x11C, PIN_INPUT, 12) /* (AA24) PRG0_PRU1_GPO7.MCASP1_AXR4 */
		>;
	};

	P8_40_uart2_txd: P8-40-uart2-txd-pins {
		pinctrl-single,pins = <
			J721E_IOPAD(0x11C, PIN_OUTPUT, 14) /* (AA24) PRG0_PRU1_GPO7.UART2_TXD */
		>;
	};

	P8_41_gpio: P8-41-gpio-pins {
		pinctrl-single,pins = <
			J721E_IOPAD(0x110, PIN_INPUT, 7) /* (AD29) PRG0_PRU1_GPO4.GPIO0_67 */
		>;
	};

	P8_41_gpio_pu: P8-41-gpio-pu-pins {
		pinctrl-single,pins = <
			J721E_IOPAD(0x110, PIN_INPUT_PULLUP, 7) /* (AD29) PRG0_PRU1_GPO4.GPIO0_67 */
		>;
	};

	P8_41_gpio_pd: P8-41-gpio-pd-pins {
		pinctrl-single,pins = <
			J721E_IOPAD(0x110, PIN_INPUT_PULLDOWN, 7) /* (AD29) PRG0_PRU1_GPO4.GPIO0_67 */
		>;
	};

	P8_41_audio: P8-41-audio-pins {
		pinctrl-single,pins = <
			J721E_IOPAD(0x110, PIN_INPUT, 12) /* (AD29) PRG0_PRU1_GPO4.MCASP1_AXR2 */
		>;
	};

	P8_42_gpio: P8-42-gpio-pins {
		pinctrl-single,pins = <
			J721E_IOPAD(0x114, PIN_INPUT, 7) /* (AB27) PRG0_PRU1_GPO5.GPIO0_68 */
		>;
	};

	P8_42_gpio_pu: P8-42-gpio-pu-pins {
		pinctrl-single,pins = <
			J721E_IOPAD(0x114, PIN_INPUT_PULLUP, 7) /* (AB27) PRG0_PRU1_GPO5.GPIO0_68 */
		>;
	};

	P8_42_gpio_pd: P8-42-gpio-pd-pins {
		pinctrl-single,pins = <
			J721E_IOPAD(0x114, PIN_INPUT_PULLDOWN, 7) /* (AB27) PRG0_PRU1_GPO5.GPIO0_68 */
		>;
	};

	P8_42_audio: P8-42-audio-pins {
		pinctrl-single,pins = <
			J721E_IOPAD(0x114, PIN_INPUT, 12) /* (AB27) PRG0_PRU1_GPO5.MCASP1_ACLKX */
		>;
	};

	P8_43_gpio: P8-43-gpio-pins {
		pinctrl-single,pins = <
			J721E_IOPAD(0x108, PIN_INPUT, 7) /* (AD27) PRG0_PRU1_GPO2.GPIO0_65 */
		>;
	};

	P8_43_gpio_pu: P8-43-gpio-pu-pins {
		pinctrl-single,pins = <
			J721E_IOPAD(0x108, PIN_INPUT_PULLUP, 7) /* (AD27) PRG0_PRU1_GPO2.GPIO0_65 */
		>;
	};

	P8_43_gpio_pd: P8-43-gpio-pd-pins {
		pinctrl-single,pins = <
			J721E_IOPAD(0x108, PIN_INPUT_PULLDOWN, 7) /* (AD27) PRG0_PRU1_GPO2.GPIO0_65 */
		>;
	};

	P8_43_audio: P8-43-audio-pins {
		pinctrl-single,pins = <
			J721E_IOPAD(0x108, PIN_INPUT, 12) /* (AD27) PRG0_PRU1_GPO2.MCASP1_ACLKR */
		>;
	};

	P8_43_audio: P8-43-audio-pins {
		pinctrl-single,pins = <
			J721E_IOPAD(0x108, PIN_INPUT, 13) /* (AD27) PRG0_PRU1_GPO2.MCASP1_AXR10 */
		>;
	};

	P8_44_gpio: P8-44-gpio-pins {
		pinctrl-single,pins = <
			J721E_IOPAD(0x10C, PIN_INPUT, 7) /* (AC25) PRG0_PRU1_GPO3.GPIO0_66 */
		>;
	};

	P8_44_gpio_pu: P8-44-gpio-pu-pins {
		pinctrl-single,pins = <
			J721E_IOPAD(0x10C, PIN_INPUT_PULLUP, 7) /* (AC25) PRG0_PRU1_GPO3.GPIO0_66 */
		>;
	};

	P8_44_gpio_pd: P8-44-gpio-pd-pins {
		pinctrl-single,pins = <
			J721E_IOPAD(0x10C, PIN_INPUT_PULLDOWN, 7) /* (AC25) PRG0_PRU1_GPO3.GPIO0_66 */
		>;
	};

	P8_44_audio: P8-44-audio-pins {
		pinctrl-single,pins = <
			J721E_IOPAD(0x10C, PIN_INPUT, 12) /* (AC25) PRG0_PRU1_GPO3.MCASP1_AFSR */
		>;
	};

	P8_44_audio: P8-44-audio-pins {
		pinctrl-single,pins = <
			J721E_IOPAD(0x10C, PIN_INPUT, 13) /* (AC25) PRG0_PRU1_GPO3.MCASP1_AXR11 */
		>;
	};

	P8_45_gpio: P8-45-gpio-pins {
		pinctrl-single,pins = <
			J721E_IOPAD(0x140, PIN_INPUT, 7) /* (AG29) PRG0_PRU1_GPO16.GPIO0_79 */
		>;
	};

	P8_45_gpio_pu: P8-45-gpio-pu-pins {
		pinctrl-single,pins = <
			J721E_IOPAD(0x140, PIN_INPUT_PULLUP, 7) /* (AG29) PRG0_PRU1_GPO16.GPIO0_79 */
		>;
	};

	P8_45_gpio_pd: P8-45-gpio-pd-pins {
		pinctrl-single,pins = <
			J721E_IOPAD(0x140, PIN_INPUT_PULLDOWN, 7) /* (AG29) PRG0_PRU1_GPO16.GPIO0_79 */
		>;
	};

	P8_45_audio: P8-45-audio-pins {
		pinctrl-single,pins = <
			J721E_IOPAD(0x140, PIN_INPUT, 12) /* (AG29) PRG0_PRU1_GPO16.MCASP2_AXR2 */
		>;
	};

	P8_46_gpio: P8-46-gpio-pins {
		pinctrl-single,pins = <
			J721E_IOPAD(0x144, PIN_INPUT, 7) /* (Y25) PRG0_PRU1_GPO17.GPIO0_80 */
		>;
	};

	P8_46_gpio_pu: P8-46-gpio-pu-pins {
		pinctrl-single,pins = <
			J721E_IOPAD(0x144, PIN_INPUT_PULLUP, 7) /* (Y25) PRG0_PRU1_GPO17.GPIO0_80 */
		>;
	};

	P8_46_gpio_pd: P8-46-gpio-pd-pins {
		pinctrl-single,pins = <
			J721E_IOPAD(0x144, PIN_INPUT_PULLDOWN, 7) /* (Y25) PRG0_PRU1_GPO17.GPIO0_80 */
		>;
	};

	P8_46_audio: P8-46-audio-pins {
		pinctrl-single,pins = <
			J721E_IOPAD(0x144, PIN_INPUT, 12) /* (Y25) PRG0_PRU1_GPO17.MCASP2_AXR3 */
		>;
	};

	P9_11_gpio: P9-11-gpio-pins {
		pinctrl-single,pins = <
			J721E_IOPAD(0x4, PIN_INPUT, 7) /* (AC23) PRG1_PRU0_GPO0.GPIO0_1 */
		>;
	};

	P9_11_gpio_pu: P9-11-gpio-pu-pins {
		pinctrl-single,pins = <
			J721E_IOPAD(0x4, PIN_INPUT_PULLUP, 7) /* (AC23) PRG1_PRU0_GPO0.GPIO0_1 */
		>;
	};

	P9_11_gpio_pd: P9-11-gpio-pd-pins {
		pinctrl-single,pins = <
			J721E_IOPAD(0x4, PIN_INPUT_PULLDOWN, 7) /* (AC23) PRG1_PRU0_GPO0.GPIO0_1 */
		>;
	};

	P9_11_audio: P9-11-audio-pins {
		pinctrl-single,pins = <
			J721E_IOPAD(0x4, PIN_INPUT, 12) /* (AC23) PRG1_PRU0_GPO0.MCASP6_ACLKX */
		>;
	};

	P9_11_uart0_rxd: P9-11-uart0-rxd-pins {
		pinctrl-single,pins = <
			J721E_IOPAD(0x4, PIN_INPUT, 14) /* (AC23) PRG1_PRU0_GPO0.UART0_RXD */
		>;
	};

	P9_12_gpio: P9-12-gpio-pins {
		pinctrl-single,pins = <
			J721E_IOPAD(0xB8, PIN_INPUT, 7) /* (AE27) PRG0_PRU0_GPO2.GPIO0_45 */
		>;
	};

	P9_12_gpio_pu: P9-12-gpio-pu-pins {
		pinctrl-single,pins = <
			J721E_IOPAD(0xB8, PIN_INPUT_PULLUP, 7) /* (AE27) PRG0_PRU0_GPO2.GPIO0_45 */
		>;
	};

	P9_12_gpio_pd: P9-12-gpio-pd-pins {
		pinctrl-single,pins = <
			J721E_IOPAD(0xB8, PIN_INPUT_PULLDOWN, 7) /* (AE27) PRG0_PRU0_GPO2.GPIO0_45 */
		>;
	};

	P9_12_uart3_rxd: P9-12-uart3-rxd-pins {
		pinctrl-single,pins = <
			J721E_IOPAD(0xB8, PIN_INPUT, 8) /* (AE27) PRG0_PRU0_GPO2.UART3_RXD */
		>;
	};

	P9_12_audio: P9-12-audio-pins {
		pinctrl-single,pins = <
			J721E_IOPAD(0xB8, PIN_INPUT, 12) /* (AE27) PRG0_PRU0_GPO2.MCASP0_ACLKR */
		>;
	};

	P9_13_gpio: P9-13-gpio-pins {
		pinctrl-single,pins = <
			J721E_IOPAD(0x8, PIN_INPUT, 7) /* (AG22) PRG1_PRU0_GPO1.GPIO0_2 */
		>;
	};

	P9_13_gpio_pu: P9-13-gpio-pu-pins {
		pinctrl-single,pins = <
			J721E_IOPAD(0x8, PIN_INPUT_PULLUP, 7) /* (AG22) PRG1_PRU0_GPO1.GPIO0_2 */
		>;
	};

	P9_13_gpio_pd: P9-13-gpio-pd-pins {
		pinctrl-single,pins = <
			J721E_IOPAD(0x8, PIN_INPUT_PULLDOWN, 7) /* (AG22) PRG1_PRU0_GPO1.GPIO0_2 */
		>;
	};

	P9_13_audio: P9-13-audio-pins {
		pinctrl-single,pins = <
			J721E_IOPAD(0x8, PIN_INPUT, 12) /* (AG22) PRG1_PRU0_GPO1.MCASP6_AFSX */
		>;
	};

	P9_13_uart0_txd: P9-13-uart0-txd-pins {
		pinctrl-single,pins = <
			J721E_IOPAD(0x8, PIN_OUTPUT, 14) /* (AG22) PRG1_PRU0_GPO1.UART0_TXD */
		>;
	};

	P9_14_uart6_rxd: P9-14-uart6-rxd-pins {
		pinctrl-single,pins = <
			J721E_IOPAD(0x178, PIN_INPUT, 3) /* (U27) RGMII5_RD3.UART6_RXD */
		>;
	};

	P9_14_pwm: P9-14-pwm-pins {
		pinctrl-single,pins = <
			J721E_IOPAD(0x178, PIN_OUTPUT, 6) /* (U27) RGMII5_RD3.EHRPWM2_A */
		>;
	};

	P9_14_gpio: P9-14-gpio-pins {
		pinctrl-single,pins = <
			J721E_IOPAD(0x178, PIN_INPUT, 7) /* (U27) RGMII5_RD3.GPIO0_93 */
		>;
	};

	P9_14_gpio_pu: P9-14-gpio-pu-pins {
		pinctrl-single,pins = <
			J721E_IOPAD(0x178, PIN_INPUT_PULLUP, 7) /* (U27) RGMII5_RD3.GPIO0_93 */
		>;
	};

	P9_14_gpio_pd: P9-14-gpio-pd-pins {
		pinctrl-single,pins = <
			J721E_IOPAD(0x178, PIN_INPUT_PULLDOWN, 7) /* (U27) RGMII5_RD3.GPIO0_93 */
		>;
	};

	P9_14_audio: P9-14-audio-pins {
		pinctrl-single,pins = <
			J721E_IOPAD(0x178, PIN_INPUT, 12) /* (U27) RGMII5_RD3.MCASP11_AXR0 */
		>;
	};

	P9_15_gpio: P9-15-gpio-pins {
		pinctrl-single,pins = <
			J721E_IOPAD(0xC0, PIN_INPUT, 7) /* (AD25) PRG0_PRU0_GPO4.GPIO0_47 */
		>;
	};

	P9_15_gpio_pu: P9-15-gpio-pu-pins {
		pinctrl-single,pins = <
			J721E_IOPAD(0xC0, PIN_INPUT_PULLUP, 7) /* (AD25) PRG0_PRU0_GPO4.GPIO0_47 */
		>;
	};

	P9_15_gpio_pd: P9-15-gpio-pd-pins {
		pinctrl-single,pins = <
			J721E_IOPAD(0xC0, PIN_INPUT_PULLDOWN, 7) /* (AD25) PRG0_PRU0_GPO4.GPIO0_47 */
		>;
	};

	P9_15_audio: P9-15-audio-pins {
		pinctrl-single,pins = <
			J721E_IOPAD(0xC0, PIN_INPUT, 12) /* (AD25) PRG0_PRU0_GPO4.MCASP0_AXR2 */
		>;
	};

	P9_16_uart6_txd: P9-16-uart6-txd-pins {
		pinctrl-single,pins = <
			J721E_IOPAD(0x17C, PIN_OUTPUT, 3) /* (U24) RGMII5_RD2.UART6_TXD */
		>;
	};

	P9_16_pwm: P9-16-pwm-pins {
		pinctrl-single,pins = <
			J721E_IOPAD(0x17C, PIN_OUTPUT, 6) /* (U24) RGMII5_RD2.EHRPWM2_B */
		>;
	};

	P9_16_gpio: P9-16-gpio-pins {
		pinctrl-single,pins = <
			J721E_IOPAD(0x17C, PIN_INPUT, 7) /* (U24) RGMII5_RD2.GPIO0_94 */
		>;
	};

	P9_16_gpio_pu: P9-16-gpio-pu-pins {
		pinctrl-single,pins = <
			J721E_IOPAD(0x17C, PIN_INPUT_PULLUP, 7) /* (U24) RGMII5_RD2.GPIO0_94 */
		>;
	};

	P9_16_gpio_pd: P9-16-gpio-pd-pins {
		pinctrl-single,pins = <
			J721E_IOPAD(0x17C, PIN_INPUT_PULLDOWN, 7) /* (U24) RGMII5_RD2.GPIO0_94 */
		>;
	};

	P9_16_audio: P9-16-audio-pins {
		pinctrl-single,pins = <
			J721E_IOPAD(0x17C, PIN_INPUT, 12) /* (U24) RGMII5_RD2.MCASP11_AXR1 */
		>;
	};

	P9_17A_gpio: P9-17A-gpio-pins {
		pinctrl-single,pins = <
			J721E_IOPAD(0x74, PIN_INPUT, 7) /* (AC21) PRG1_PRU1_GPO7.GPIO0_28 */
		>;
	};

	P9_17A_gpio_pu: P9-17A-gpio-pu-pins {
		pinctrl-single,pins = <
			J721E_IOPAD(0x74, PIN_INPUT_PULLUP, 7) /* (AC21) PRG1_PRU1_GPO7.GPIO0_28 */
		>;
	};

	P9_17A_gpio_pd: P9-17A-gpio-pd-pins {
		pinctrl-single,pins = <
			J721E_IOPAD(0x74, PIN_INPUT_PULLDOWN, 7) /* (AC21) PRG1_PRU1_GPO7.GPIO0_28 */
		>;
	};

	P9_17A_audio: P9-17A-audio-pins {
		pinctrl-single,pins = <
			J721E_IOPAD(0x74, PIN_INPUT, 12) /* (AC21) PRG1_PRU1_GPO7.MCASP4_AXR1 */
		>;
	};

	P9_17A_uart3_txd: P9-17A-uart3-txd-pins {
		pinctrl-single,pins = <
			J721E_IOPAD(0x74, PIN_OUTPUT, 14) /* (AC21) PRG1_PRU1_GPO7.UART3_TXD */
		>;
	};

	P9_17B_i2c: P9-17B-i2c-pins {
		pinctrl-single,pins = <
			J721E_IOPAD(0x1D0, PIN_INPUT_PULLUP, 2) /* (AA3) SPI0_D1.I2C6_SCL */
		>;
	};

	P9_17B_gpio: P9-17B-gpio-pins {
		pinctrl-single,pins = <
			J721E_IOPAD(0x1D0, PIN_INPUT, 7) /* (AA3) SPI0_D1.GPIO0_115 */
		>;
	};

	P9_17B_gpio_pu: P9-17B-gpio-pu-pins {
		pinctrl-single,pins = <
			J721E_IOPAD(0x1D0, PIN_INPUT_PULLUP, 7) /* (AA3) SPI0_D1.GPIO0_115 */
		>;
	};

	P9_17B_gpio_pd: P9-17B-gpio-pd-pins {
		pinctrl-single,pins = <
			J721E_IOPAD(0x1D0, PIN_INPUT_PULLDOWN, 7) /* (AA3) SPI0_D1.GPIO0_115 */
		>;
	};

	P9_18A_gpio: P9-18A-gpio-pins {
		pinctrl-single,pins = <
			J721E_IOPAD(0xA4, PIN_INPUT, 7) /* (AH22) PRG1_PRU1_GPO19.GPIO0_40 */
		>;
	};

	P9_18A_gpio_pu: P9-18A-gpio-pu-pins {
		pinctrl-single,pins = <
			J721E_IOPAD(0xA4, PIN_INPUT_PULLUP, 7) /* (AH22) PRG1_PRU1_GPO19.GPIO0_40 */
		>;
	};

	P9_18A_gpio_pd: P9-18A-gpio-pd-pins {
		pinctrl-single,pins = <
			J721E_IOPAD(0xA4, PIN_INPUT_PULLDOWN, 7) /* (AH22) PRG1_PRU1_GPO19.GPIO0_40 */
		>;
	};

	P9_18A_audio: P9-18A-audio-pins {
		pinctrl-single,pins = <
			J721E_IOPAD(0xA4, PIN_INPUT, 12) /* (AH22) PRG1_PRU1_GPO19.MCASP5_AXR1 */
		>;
	};

	P9_18B_i2c: P9-18B-i2c-pins {
		pinctrl-single,pins = <
			J721E_IOPAD(0x1E4, PIN_INPUT_PULLUP, 2) /* (Y2) SPI1_D1.I2C6_SDA */
		>;
	};

	P9_18B_gpio: P9-18B-gpio-pins {
		pinctrl-single,pins = <
			J721E_IOPAD(0x1E4, PIN_INPUT, 7) /* (Y2) SPI1_D1.GPIO0_120 */
		>;
	};

	P9_18B_gpio_pu: P9-18B-gpio-pu-pins {
		pinctrl-single,pins = <
			J721E_IOPAD(0x1E4, PIN_INPUT_PULLUP, 7) /* (Y2) SPI1_D1.GPIO0_120 */
		>;
	};

	P9_18B_gpio_pd: P9-18B-gpio-pd-pins {
		pinctrl-single,pins = <
			J721E_IOPAD(0x1E4, PIN_INPUT_PULLDOWN, 7) /* (Y2) SPI1_D1.GPIO0_120 */
		>;
	};

	P9_19A_i2c: P9-19A-i2c-pins {
		pinctrl-single,pins = <
			J721E_IOPAD(0x208, PIN_INPUT_PULLUP, 4) /* (W5) MCAN0_RX.I2C2_SCL */
		>;
	};

	P9_19A_gpio: P9-19A-gpio-pins {
		pinctrl-single,pins = <
			J721E_IOPAD(0x208, PIN_INPUT, 7) /* (W5) MCAN0_RX.GPIO1_1 */
		>;
	};

	P9_19A_gpio_pu: P9-19A-gpio-pu-pins {
		pinctrl-single,pins = <
			J721E_IOPAD(0x208, PIN_INPUT_PULLUP, 7) /* (W5) MCAN0_RX.GPIO1_1 */
		>;
	};

	P9_19A_gpio_pd: P9-19A-gpio-pd-pins {
		pinctrl-single,pins = <
			J721E_IOPAD(0x208, PIN_INPUT_PULLDOWN, 7) /* (W5) MCAN0_RX.GPIO1_1 */
		>;
	};

	P9_19B_gpio: P9-19B-gpio-pins {
		pinctrl-single,pins = <
			J721E_IOPAD(0x13C, PIN_INPUT, 7) /* (AF29) PRG0_PRU1_GPO15.GPIO0_78 */
		>;
	};

	P9_19B_gpio_pu: P9-19B-gpio-pu-pins {
		pinctrl-single,pins = <
			J721E_IOPAD(0x13C, PIN_INPUT_PULLUP, 7) /* (AF29) PRG0_PRU1_GPO15.GPIO0_78 */
		>;
	};

	P9_19B_gpio_pd: P9-19B-gpio-pd-pins {
		pinctrl-single,pins = <
			J721E_IOPAD(0x13C, PIN_INPUT_PULLDOWN, 7) /* (AF29) PRG0_PRU1_GPO15.GPIO0_78 */
		>;
	};

	P9_19B_audio: P9-19B-audio-pins {
		pinctrl-single,pins = <
			J721E_IOPAD(0x13C, PIN_INPUT, 12) /* (AF29) PRG0_PRU1_GPO15.MCASP2_AXR1 */
		>;
	};

	P9_20A_i2c: P9-20A-i2c-pins {
		pinctrl-single,pins = <
			J721E_IOPAD(0x20C, PIN_INPUT_PULLUP, 4) /* (W6) MCAN0_TX.I2C2_SDA */
		>;
	};

	P9_20A_gpio: P9-20A-gpio-pins {
		pinctrl-single,pins = <
			J721E_IOPAD(0x20C, PIN_INPUT, 7) /* (W6) MCAN0_TX.GPIO1_2 */
		>;
	};

	P9_20A_gpio_pu: P9-20A-gpio-pu-pins {
		pinctrl-single,pins = <
			J721E_IOPAD(0x20C, PIN_INPUT_PULLUP, 7) /* (W6) MCAN0_TX.GPIO1_2 */
		>;
	};

	P9_20A_gpio_pd: P9-20A-gpio-pd-pins {
		pinctrl-single,pins = <
			J721E_IOPAD(0x20C, PIN_INPUT_PULLDOWN, 7) /* (W6) MCAN0_TX.GPIO1_2 */
		>;
	};

	P9_20B_gpio: P9-20B-gpio-pins {
		pinctrl-single,pins = <
			J721E_IOPAD(0x138, PIN_INPUT, 7) /* (AE25) PRG0_PRU1_GPO14.GPIO0_77 */
		>;
	};

	P9_20B_gpio_pu: P9-20B-gpio-pu-pins {
		pinctrl-single,pins = <
			J721E_IOPAD(0x138, PIN_INPUT_PULLUP, 7) /* (AE25) PRG0_PRU1_GPO14.GPIO0_77 */
		>;
	};

	P9_20B_gpio_pd: P9-20B-gpio-pd-pins {
		pinctrl-single,pins = <
			J721E_IOPAD(0x138, PIN_INPUT_PULLDOWN, 7) /* (AE25) PRG0_PRU1_GPO14.GPIO0_77 */
		>;
	};

	P9_20B_audio: P9-20B-audio-pins {
		pinctrl-single,pins = <
			J721E_IOPAD(0x138, PIN_INPUT, 12) /* (AE25) PRG0_PRU1_GPO14.MCASP2_AXR0 */
		>;
	};

	P9_21A_gpio: P9-21A-gpio-pins {
		pinctrl-single,pins = <
			J721E_IOPAD(0xA0, PIN_INPUT, 7) /* (AJ22) PRG1_PRU1_GPO18.GPIO0_39 */
		>;
	};

	P9_21A_gpio_pu: P9-21A-gpio-pu-pins {
		pinctrl-single,pins = <
			J721E_IOPAD(0xA0, PIN_INPUT_PULLUP, 7) /* (AJ22) PRG1_PRU1_GPO18.GPIO0_39 */
		>;
	};

	P9_21A_gpio_pd: P9-21A-gpio-pd-pins {
		pinctrl-single,pins = <
			J721E_IOPAD(0xA0, PIN_INPUT_PULLDOWN, 7) /* (AJ22) PRG1_PRU1_GPO18.GPIO0_39 */
		>;
	};

	P9_21A_audio: P9-21A-audio-pins {
		pinctrl-single,pins = <
			J721E_IOPAD(0xA0, PIN_INPUT, 12) /* (AJ22) PRG1_PRU1_GPO18.MCASP5_AXR0 */
		>;
	};

	P9_21B_i2c: P9-21B-i2c-pins {
		pinctrl-single,pins = <
			J721E_IOPAD(0x16C, PIN_INPUT_PULLUP, 2) /* (U28) RGMII5_TD0.I2C3_SDA */
		>;
	};

	P9_21B_pwm: P9-21B-pwm-pins {
		pinctrl-single,pins = <
			J721E_IOPAD(0x16C, PIN_OUTPUT, 6) /* (U28) RGMII5_TD0.EHRPWM1_A */
		>;
	};

	P9_21B_gpio: P9-21B-gpio-pins {
		pinctrl-single,pins = <
			J721E_IOPAD(0x16C, PIN_INPUT, 7) /* (U28) RGMII5_TD0.GPIO0_90 */
		>;
	};

	P9_21B_gpio_pu: P9-21B-gpio-pu-pins {
		pinctrl-single,pins = <
			J721E_IOPAD(0x16C, PIN_INPUT_PULLUP, 7) /* (U28) RGMII5_TD0.GPIO0_90 */
		>;
	};

	P9_21B_gpio_pd: P9-21B-gpio-pd-pins {
		pinctrl-single,pins = <
			J721E_IOPAD(0x16C, PIN_INPUT_PULLDOWN, 7) /* (U28) RGMII5_TD0.GPIO0_90 */
		>;
	};

	P9_21B_audio: P9-21B-audio-pins {
		pinctrl-single,pins = <
			J721E_IOPAD(0x16C, PIN_INPUT, 12) /* (U28) RGMII5_TD0.MCASP11_AFSX */
		>;
	};

	P9_22A_gpio: P9-22A-gpio-pins {
		pinctrl-single,pins = <
			J721E_IOPAD(0x9C, PIN_INPUT, 7) /* (AC22) PRG1_PRU1_GPO17.GPIO0_38 */
		>;
	};

	P9_22A_gpio_pu: P9-22A-gpio-pu-pins {
		pinctrl-single,pins = <
			J721E_IOPAD(0x9C, PIN_INPUT_PULLUP, 7) /* (AC22) PRG1_PRU1_GPO17.GPIO0_38 */
		>;
	};

	P9_22A_gpio_pd: P9-22A-gpio-pd-pins {
		pinctrl-single,pins = <
			J721E_IOPAD(0x9C, PIN_INPUT_PULLDOWN, 7) /* (AC22) PRG1_PRU1_GPO17.GPIO0_38 */
		>;
	};

	P9_22A_audio: P9-22A-audio-pins {
		pinctrl-single,pins = <
			J721E_IOPAD(0x9C, PIN_INPUT, 12) /* (AC22) PRG1_PRU1_GPO17.MCASP5_AFSX */
		>;
	};

	P9_22B_i2c: P9-22B-i2c-pins {
		pinctrl-single,pins = <
			J721E_IOPAD(0x170, PIN_INPUT_PULLUP, 2) /* (U29) RGMII5_TXC.I2C6_SCL */
		>;
	};

	P9_22B_pwm: P9-22B-pwm-pins {
		pinctrl-single,pins = <
			J721E_IOPAD(0x170, PIN_OUTPUT, 6) /* (U29) RGMII5_TXC.EHRPWM1_B */
		>;
	};

	P9_22B_gpio: P9-22B-gpio-pins {
		pinctrl-single,pins = <
			J721E_IOPAD(0x170, PIN_INPUT, 7) /* (U29) RGMII5_TXC.GPIO0_91 */
		>;
	};

	P9_22B_gpio_pu: P9-22B-gpio-pu-pins {
		pinctrl-single,pins = <
			J721E_IOPAD(0x170, PIN_INPUT_PULLUP, 7) /* (U29) RGMII5_TXC.GPIO0_91 */
		>;
	};

	P9_22B_gpio_pd: P9-22B-gpio-pd-pins {
		pinctrl-single,pins = <
			J721E_IOPAD(0x170, PIN_INPUT_PULLDOWN, 7) /* (U29) RGMII5_TXC.GPIO0_91 */
		>;
	};

	P9_22B_audio: P9-22B-audio-pins {
		pinctrl-single,pins = <
			J721E_IOPAD(0x170, PIN_INPUT, 12) /* (U29) RGMII5_TXC.MCASP10_AXR2 */
		>;
	};

	P9_23_gpio: P9-23-gpio-pins {
		pinctrl-single,pins = <
			J721E_IOPAD(0x28, PIN_INPUT, 7) /* (AG20) PRG1_PRU0_GPO9.GPIO0_10 */
		>;
	};

	P9_23_gpio_pu: P9-23-gpio-pu-pins {
		pinctrl-single,pins = <
			J721E_IOPAD(0x28, PIN_INPUT_PULLUP, 7) /* (AG20) PRG1_PRU0_GPO9.GPIO0_10 */
		>;
	};

	P9_23_gpio_pd: P9-23-gpio-pd-pins {
		pinctrl-single,pins = <
			J721E_IOPAD(0x28, PIN_INPUT_PULLDOWN, 7) /* (AG20) PRG1_PRU0_GPO9.GPIO0_10 */
		>;
	};

	P9_23_audio: P9-23-audio-pins {
		pinctrl-single,pins = <
			J721E_IOPAD(0x28, PIN_INPUT, 12) /* (AG20) PRG1_PRU0_GPO9.MCASP3_ACLKX */
		>;
	};

	P9_24A_i2c: P9-24A-i2c-pins {
		pinctrl-single,pins = <
			J721E_IOPAD(0x1E0, PIN_INPUT_PULLUP, 2) /* (Y5) SPI1_D0.I2C4_SCL */
		>;
	};

	P9_24A_uart2_txd: P9-24A-uart2-txd-pins {
		pinctrl-single,pins = <
			J721E_IOPAD(0x1E0, PIN_OUTPUT, 3) /* (Y5) SPI1_D0.UART2_TXD */
		>;
	};

	P9_24A_gpio: P9-24A-gpio-pins {
		pinctrl-single,pins = <
			J721E_IOPAD(0x1E0, PIN_INPUT, 7) /* (Y5) SPI1_D0.GPIO0_119 */
		>;
	};

	P9_24A_gpio_pu: P9-24A-gpio-pu-pins {
		pinctrl-single,pins = <
			J721E_IOPAD(0x1E0, PIN_INPUT_PULLUP, 7) /* (Y5) SPI1_D0.GPIO0_119 */
		>;
	};

	P9_24A_gpio_pd: P9-24A-gpio-pd-pins {
		pinctrl-single,pins = <
			J721E_IOPAD(0x1E0, PIN_INPUT_PULLDOWN, 7) /* (Y5) SPI1_D0.GPIO0_119 */
		>;
	};

	P9_24B_gpio: P9-24B-gpio-pins {
		pinctrl-single,pins = <
			J721E_IOPAD(0x34, PIN_INPUT, 7) /* (AJ24) PRG1_PRU0_GPO12.GPIO0_13 */
		>;
	};

	P9_24B_gpio_pu: P9-24B-gpio-pu-pins {
		pinctrl-single,pins = <
			J721E_IOPAD(0x34, PIN_INPUT_PULLUP, 7) /* (AJ24) PRG1_PRU0_GPO12.GPIO0_13 */
		>;
	};

	P9_24B_gpio_pd: P9-24B-gpio-pd-pins {
		pinctrl-single,pins = <
			J721E_IOPAD(0x34, PIN_INPUT_PULLDOWN, 7) /* (AJ24) PRG1_PRU0_GPO12.GPIO0_13 */
		>;
	};

	P9_24B_audio: P9-24B-audio-pins {
		pinctrl-single,pins = <
			J721E_IOPAD(0x34, PIN_INPUT, 12) /* (AJ24) PRG1_PRU0_GPO12.MCASP7_AFSX */
		>;
	};

	P9_25A_spi: P9-25A-spi-pins {
		pinctrl-single,pins = <
			J721E_IOPAD(0x200, PIN_INPUT, 4) /* (AC4) UART1_CTSn.SPI2_D0 */
		>;
	};

	P9_25A_eqep: P9-25A-eqep-pins {
		pinctrl-single,pins = <
			J721E_IOPAD(0x200, PIN_INPUT, 5) /* (AC4) UART1_CTSn.EQEP0_S */
		>;
	};

	P9_25A_gpio: P9-25A-gpio-pins {
		pinctrl-single,pins = <
			J721E_IOPAD(0x200, PIN_INPUT, 7) /* (AC4) UART1_CTSn.GPIO0_127 */
		>;
	};

	P9_25A_gpio_pu: P9-25A-gpio-pu-pins {
		pinctrl-single,pins = <
			J721E_IOPAD(0x200, PIN_INPUT_PULLUP, 7) /* (AC4) UART1_CTSn.GPIO0_127 */
		>;
	};

	P9_25A_gpio_pd: P9-25A-gpio-pd-pins {
		pinctrl-single,pins = <
			J721E_IOPAD(0x200, PIN_INPUT_PULLDOWN, 7) /* (AC4) UART1_CTSn.GPIO0_127 */
		>;
	};

	P9_25B_gpio: P9-25B-gpio-pins {
		pinctrl-single,pins = <
			J721E_IOPAD(0x1A4, PIN_INPUT, 7) /* (W26) RGMII6_RXC.GPIO0_104 */
		>;
	};

	P9_25B_gpio_pu: P9-25B-gpio-pu-pins {
		pinctrl-single,pins = <
			J721E_IOPAD(0x1A4, PIN_INPUT_PULLUP, 7) /* (W26) RGMII6_RXC.GPIO0_104 */
		>;
	};

	P9_25B_gpio_pd: P9-25B-gpio-pd-pins {
		pinctrl-single,pins = <
			J721E_IOPAD(0x1A4, PIN_INPUT_PULLDOWN, 7) /* (W26) RGMII6_RXC.GPIO0_104 */
		>;
	};

	P9_25B_audio: P9-25B-audio-pins {
		pinctrl-single,pins = <
			J721E_IOPAD(0x1A4, PIN_INPUT, 12) /* (W26) RGMII6_RXC.MCASP10_AXR7 */
		>;
	};

	P9_26A_i2c: P9-26A-i2c-pins {
		pinctrl-single,pins = <
			J721E_IOPAD(0x1DC, PIN_INPUT_PULLUP, 2) /* (Y1) SPI1_CLK.I2C4_SDA */
		>;
	};

	P9_26A_uart2_rxd: P9-26A-uart2-rxd-pins {
		pinctrl-single,pins = <
			J721E_IOPAD(0x1DC, PIN_INPUT, 3) /* (Y1) SPI1_CLK.UART2_RXD */
		>;
	};

	P9_26A_gpio: P9-26A-gpio-pins {
		pinctrl-single,pins = <
			J721E_IOPAD(0x1DC, PIN_INPUT, 7) /* (Y1) SPI1_CLK.GPIO0_118 */
		>;
	};

	P9_26A_gpio_pu: P9-26A-gpio-pu-pins {
		pinctrl-single,pins = <
			J721E_IOPAD(0x1DC, PIN_INPUT_PULLUP, 7) /* (Y1) SPI1_CLK.GPIO0_118 */
		>;
	};

	P9_26A_gpio_pd: P9-26A-gpio-pd-pins {
		pinctrl-single,pins = <
			J721E_IOPAD(0x1DC, PIN_INPUT_PULLDOWN, 7) /* (Y1) SPI1_CLK.GPIO0_118 */
		>;
	};

	P9_26B_gpio: P9-26B-gpio-pins {
		pinctrl-single,pins = <
			J721E_IOPAD(0x30, PIN_INPUT, 7) /* (AF24) PRG1_PRU0_GPO11.GPIO0_12 */
		>;
	};

	P9_26B_gpio_pu: P9-26B-gpio-pu-pins {
		pinctrl-single,pins = <
			J721E_IOPAD(0x30, PIN_INPUT_PULLUP, 7) /* (AF24) PRG1_PRU0_GPO11.GPIO0_12 */
		>;
	};

	P9_26B_gpio_pd: P9-26B-gpio-pd-pins {
		pinctrl-single,pins = <
			J721E_IOPAD(0x30, PIN_INPUT_PULLDOWN, 7) /* (AF24) PRG1_PRU0_GPO11.GPIO0_12 */
		>;
	};

	P9_26B_audio: P9-26B-audio-pins {
		pinctrl-single,pins = <
			J721E_IOPAD(0x30, PIN_INPUT, 12) /* (AF24) PRG1_PRU0_GPO11.MCASP7_ACLKX */
		>;
	};

	P9_27A_gpio: P9-27A-gpio-pins {
		pinctrl-single,pins = <
			J721E_IOPAD(0xBC, PIN_INPUT, 7) /* (AD26) PRG0_PRU0_GPO3.GPIO0_46 */
		>;
	};

	P9_27A_gpio_pu: P9-27A-gpio-pu-pins {
		pinctrl-single,pins = <
			J721E_IOPAD(0xBC, PIN_INPUT_PULLUP, 7) /* (AD26) PRG0_PRU0_GPO3.GPIO0_46 */
		>;
	};

	P9_27A_gpio_pd: P9-27A-gpio-pd-pins {
		pinctrl-single,pins = <
			J721E_IOPAD(0xBC, PIN_INPUT_PULLDOWN, 7) /* (AD26) PRG0_PRU0_GPO3.GPIO0_46 */
		>;
	};

	P9_27A_uart3_txd: P9-27A-uart3-txd-pins {
		pinctrl-single,pins = <
			J721E_IOPAD(0xBC, PIN_OUTPUT, 8) /* (AD26) PRG0_PRU0_GPO3.UART3_TXD */
		>;
	};

	P9_27A_audio: P9-27A-audio-pins {
		pinctrl-single,pins = <
			J721E_IOPAD(0xBC, PIN_INPUT, 12) /* (AD26) PRG0_PRU0_GPO3.MCASP0_AFSR */
		>;
	};

	P9_27B_spi: P9-27B-spi-pins {
		pinctrl-single,pins = <
			J721E_IOPAD(0x1F4, PIN_INPUT, 4) /* (AB1) UART0_RTSn.SPI2_CLK */
		>;
	};

	P9_27B_eqep: P9-27B-eqep-pins {
		pinctrl-single,pins = <
			J721E_IOPAD(0x1F4, PIN_INPUT, 5) /* (AB1) UART0_RTSn.EQEP0_B */
		>;
	};

	P9_27B_gpio: P9-27B-gpio-pins {
		pinctrl-single,pins = <
			J721E_IOPAD(0x1F4, PIN_INPUT, 7) /* (AB1) UART0_RTSn.GPIO0_124 */
		>;
	};

	P9_27B_gpio_pu: P9-27B-gpio-pu-pins {
		pinctrl-single,pins = <
			J721E_IOPAD(0x1F4, PIN_INPUT_PULLUP, 7) /* (AB1) UART0_RTSn.GPIO0_124 */
		>;
	};

	P9_27B_gpio_pd: P9-27B-gpio-pd-pins {
		pinctrl-single,pins = <
			J721E_IOPAD(0x1F4, PIN_INPUT_PULLDOWN, 7) /* (AB1) UART0_RTSn.GPIO0_124 */
		>;
	};

	P9_28A_pwm_ecap: P9-28A-pwm-ecap-pins {
		pinctrl-single,pins = <
			J721E_IOPAD(0x230, PIN_OUTPUT, 0) /* (U2) ECAP0_IN_APWM_OUT */
		>;
	};

	P9_28A_spi: P9-28A-spi-pins {
		pinctrl-single,pins = <
			J721E_IOPAD(0x230, PIN_INPUT, 4) /* (U2) ECAP0_IN_APWM_OUT.SPI2_CS3 */
		>;
	};

	P9_28A_gpio: P9-28A-gpio-pins {
		pinctrl-single,pins = <
			J721E_IOPAD(0x230, PIN_INPUT, 7) /* (U2) ECAP0_IN_APWM_OUT.GPIO1_11 */
		>;
	};

	P9_28A_gpio_pu: P9-28A-gpio-pu-pins {
		pinctrl-single,pins = <
			J721E_IOPAD(0x230, PIN_INPUT_PULLUP, 7) /* (U2) ECAP0_IN_APWM_OUT.GPIO1_11 */
		>;
	};

	P9_28A_gpio_pd: P9-28A-gpio-pd-pins {
		pinctrl-single,pins = <
			J721E_IOPAD(0x230, PIN_INPUT_PULLDOWN, 7) /* (U2) ECAP0_IN_APWM_OUT.GPIO1_11 */
		>;
	};

	P9_28B_gpio: P9-28B-gpio-pins {
		pinctrl-single,pins = <
			J721E_IOPAD(0xB0, PIN_INPUT, 7) /* (AF28) PRG0_PRU0_GPO0.GPIO0_43 */
		>;
	};

	P9_28B_gpio_pu: P9-28B-gpio-pu-pins {
		pinctrl-single,pins = <
			J721E_IOPAD(0xB0, PIN_INPUT_PULLUP, 7) /* (AF28) PRG0_PRU0_GPO0.GPIO0_43 */
		>;
	};

	P9_28B_gpio_pd: P9-28B-gpio-pd-pins {
		pinctrl-single,pins = <
			J721E_IOPAD(0xB0, PIN_INPUT_PULLDOWN, 7) /* (AF28) PRG0_PRU0_GPO0.GPIO0_43 */
		>;
	};

	P9_28B_audio: P9-28B-audio-pins {
		pinctrl-single,pins = <
			J721E_IOPAD(0xB0, PIN_INPUT, 12) /* (AF28) PRG0_PRU0_GPO0.MCASP0_AXR0 */
		>;
	};

	P9_29A_pwm_ecap: P9-29A-pwm-ecap-pins {
		pinctrl-single,pins = <
			J721E_IOPAD(0x23C, PIN_OUTPUT, 1) /* (V5) TIMER_IO1.ECAP2_IN_APWM_OUT */
		>;
	};

	P9_29A_gpio: P9-29A-gpio-pins {
		pinctrl-single,pins = <
			J721E_IOPAD(0x23C, PIN_INPUT, 7) /* (V5) TIMER_IO1.GPIO1_14 */
		>;
	};

	P9_29A_gpio_pu: P9-29A-gpio-pu-pins {
		pinctrl-single,pins = <
			J721E_IOPAD(0x23C, PIN_INPUT_PULLUP, 7) /* (V5) TIMER_IO1.GPIO1_14 */
		>;
	};

	P9_29A_gpio_pd: P9-29A-gpio-pd-pins {
		pinctrl-single,pins = <
			J721E_IOPAD(0x23C, PIN_INPUT_PULLDOWN, 7) /* (V5) TIMER_IO1.GPIO1_14 */
		>;
	};

	P9_29B_gpio: P9-29B-gpio-pins {
		pinctrl-single,pins = <
			J721E_IOPAD(0xD8, PIN_INPUT, 7) /* (AB25) PRG0_PRU0_GPO10.GPIO0_53 */
		>;
	};

	P9_29B_gpio_pu: P9-29B-gpio-pu-pins {
		pinctrl-single,pins = <
			J721E_IOPAD(0xD8, PIN_INPUT_PULLUP, 7) /* (AB25) PRG0_PRU0_GPO10.GPIO0_53 */
		>;
	};

	P9_29B_gpio_pd: P9-29B-gpio-pd-pins {
		pinctrl-single,pins = <
			J721E_IOPAD(0xD8, PIN_INPUT_PULLDOWN, 7) /* (AB25) PRG0_PRU0_GPO10.GPIO0_53 */
		>;
	};

	P9_29B_audio: P9-29B-audio-pins {
		pinctrl-single,pins = <
			J721E_IOPAD(0xD8, PIN_INPUT, 12) /* (AB25) PRG0_PRU0_GPO10.MCASP0_AFSX */
		>;
	};

	P9_30A_pwm_ecap: P9-30A-pwm-ecap-pins {
		pinctrl-single,pins = <
			J721E_IOPAD(0x238, PIN_OUTPUT, 1) /* (V6) TIMER_IO0.ECAP1_IN_APWM_OUT */
		>;
	};

	P9_30A_gpio: P9-30A-gpio-pins {
		pinctrl-single,pins = <
			J721E_IOPAD(0x238, PIN_INPUT, 7) /* (V6) TIMER_IO0.GPIO1_13 */
		>;
	};

	P9_30A_gpio_pu: P9-30A-gpio-pu-pins {
		pinctrl-single,pins = <
			J721E_IOPAD(0x238, PIN_INPUT_PULLUP, 7) /* (V6) TIMER_IO0.GPIO1_13 */
		>;
	};

	P9_30A_gpio_pd: P9-30A-gpio-pd-pins {
		pinctrl-single,pins = <
			J721E_IOPAD(0x238, PIN_INPUT_PULLDOWN, 7) /* (V6) TIMER_IO0.GPIO1_13 */
		>;
	};

	P9_30B_gpio: P9-30B-gpio-pins {
		pinctrl-single,pins = <
			J721E_IOPAD(0xB4, PIN_INPUT, 7) /* (AE28) PRG0_PRU0_GPO1.GPIO0_44 */
		>;
	};

	P9_30B_gpio_pu: P9-30B-gpio-pu-pins {
		pinctrl-single,pins = <
			J721E_IOPAD(0xB4, PIN_INPUT_PULLUP, 7) /* (AE28) PRG0_PRU0_GPO1.GPIO0_44 */
		>;
	};

	P9_30B_gpio_pd: P9-30B-gpio-pd-pins {
		pinctrl-single,pins = <
			J721E_IOPAD(0xB4, PIN_INPUT_PULLDOWN, 7) /* (AE28) PRG0_PRU0_GPO1.GPIO0_44 */
		>;
	};

	P9_30B_audio: P9-30B-audio-pins {
		pinctrl-single,pins = <
			J721E_IOPAD(0xB4, PIN_INPUT, 12) /* (AE28) PRG0_PRU0_GPO1.MCASP0_AXR1 */
		>;
	};

	P9_31A_gpio: P9-31A-gpio-pins {
		pinctrl-single,pins = <
			J721E_IOPAD(0x234, PIN_INPUT, 7) /* (U3) EXT_REFCLK1.GPIO1_12 */
		>;
	};

	P9_31A_gpio_pu: P9-31A-gpio-pu-pins {
		pinctrl-single,pins = <
			J721E_IOPAD(0x234, PIN_INPUT_PULLUP, 7) /* (U3) EXT_REFCLK1.GPIO1_12 */
		>;
	};

	P9_31A_gpio_pd: P9-31A-gpio-pd-pins {
		pinctrl-single,pins = <
			J721E_IOPAD(0x234, PIN_INPUT_PULLDOWN, 7) /* (U3) EXT_REFCLK1.GPIO1_12 */
		>;
	};

	P9_31B_gpio: P9-31B-gpio-pins {
		pinctrl-single,pins = <
			J721E_IOPAD(0xD4, PIN_INPUT, 7) /* (AB26) PRG0_PRU0_GPO9.GPIO0_52 */
		>;
	};

	P9_31B_gpio_pu: P9-31B-gpio-pu-pins {
		pinctrl-single,pins = <
			J721E_IOPAD(0xD4, PIN_INPUT_PULLUP, 7) /* (AB26) PRG0_PRU0_GPO9.GPIO0_52 */
		>;
	};

	P9_31B_gpio_pd: P9-31B-gpio-pd-pins {
		pinctrl-single,pins = <
			J721E_IOPAD(0xD4, PIN_INPUT_PULLDOWN, 7) /* (AB26) PRG0_PRU0_GPO9.GPIO0_52 */
		>;
	};

	P9_31B_audio: P9-31B-audio-pins {
		pinctrl-single,pins = <
			J721E_IOPAD(0xD4, PIN_INPUT, 12) /* (AB26) PRG0_PRU0_GPO9.MCASP0_ACLKX */
		>;
	};

	P9_31B_uart6_txd: P9-31B-uart6-txd-pins {
		pinctrl-single,pins = <
			J721E_IOPAD(0xD4, PIN_OUTPUT, 14) /* (AB26) PRG0_PRU0_GPO9.UART6_TXD */
		>;
	};

	P9_33B_gpio: P9-33B-gpio-pins {
		pinctrl-single,pins = <
			J721E_IOPAD(0xCC, PIN_INPUT, 7) /* (AC28) PRG0_PRU0_GPO7.GPIO0_50 */
		>;
	};

	P9_33B_gpio_pu: P9-33B-gpio-pu-pins {
		pinctrl-single,pins = <
			J721E_IOPAD(0xCC, PIN_INPUT_PULLUP, 7) /* (AC28) PRG0_PRU0_GPO7.GPIO0_50 */
		>;
	};

	P9_33B_gpio_pd: P9-33B-gpio-pd-pins {
		pinctrl-single,pins = <
			J721E_IOPAD(0xCC, PIN_INPUT_PULLDOWN, 7) /* (AC28) PRG0_PRU0_GPO7.GPIO0_50 */
		>;
	};

	P9_33B_audio: P9-33B-audio-pins {
		pinctrl-single,pins = <
			J721E_IOPAD(0xCC, PIN_INPUT, 12) /* (AC28) PRG0_PRU0_GPO7.MCASP0_AXR5 */
		>;
	};

	P9_35B_gpio: P9-35B-gpio-pins {
		pinctrl-single,pins = <
			J721E_IOPAD(0xE0, PIN_INPUT, 7) /* (AH27) PRG0_PRU0_GPO12.GPIO0_55 */
		>;
	};

	P9_35B_gpio_pu: P9-35B-gpio-pu-pins {
		pinctrl-single,pins = <
			J721E_IOPAD(0xE0, PIN_INPUT_PULLUP, 7) /* (AH27) PRG0_PRU0_GPO12.GPIO0_55 */
		>;
	};

	P9_35B_gpio_pd: P9-35B-gpio-pd-pins {
		pinctrl-single,pins = <
			J721E_IOPAD(0xE0, PIN_INPUT_PULLDOWN, 7) /* (AH27) PRG0_PRU0_GPO12.GPIO0_55 */
		>;
	};

	P9_35B_audio: P9-35B-audio-pins {
		pinctrl-single,pins = <
			J721E_IOPAD(0xE0, PIN_INPUT, 12) /* (AH27) PRG0_PRU0_GPO12.MCASP0_AXR8 */
		>;
	};

	P9_36B_gpio: P9-36B-gpio-pins {
		pinctrl-single,pins = <
			J721E_IOPAD(0xE4, PIN_INPUT, 7) /* (AH29) PRG0_PRU0_GPO13.GPIO0_56 */
		>;
	};

	P9_36B_gpio_pu: P9-36B-gpio-pu-pins {
		pinctrl-single,pins = <
			J721E_IOPAD(0xE4, PIN_INPUT_PULLUP, 7) /* (AH29) PRG0_PRU0_GPO13.GPIO0_56 */
		>;
	};

	P9_36B_gpio_pd: P9-36B-gpio-pd-pins {
		pinctrl-single,pins = <
			J721E_IOPAD(0xE4, PIN_INPUT_PULLDOWN, 7) /* (AH29) PRG0_PRU0_GPO13.GPIO0_56 */
		>;
	};

	P9_36B_audio: P9-36B-audio-pins {
		pinctrl-single,pins = <
			J721E_IOPAD(0xE4, PIN_INPUT, 12) /* (AH29) PRG0_PRU0_GPO13.MCASP0_AXR9 */
		>;
	};

	P9_37B_gpio: P9-37B-gpio-pins {
		pinctrl-single,pins = <
			J721E_IOPAD(0xE8, PIN_INPUT, 7) /* (AG28) PRG0_PRU0_GPO14.GPIO0_57 */
		>;
	};

	P9_37B_gpio_pu: P9-37B-gpio-pu-pins {
		pinctrl-single,pins = <
			J721E_IOPAD(0xE8, PIN_INPUT_PULLUP, 7) /* (AG28) PRG0_PRU0_GPO14.GPIO0_57 */
		>;
	};

	P9_37B_gpio_pd: P9-37B-gpio-pd-pins {
		pinctrl-single,pins = <
			J721E_IOPAD(0xE8, PIN_INPUT_PULLDOWN, 7) /* (AG28) PRG0_PRU0_GPO14.GPIO0_57 */
		>;
	};

	P9_37B_uart4_rxd: P9-37B-uart4-rxd-pins {
		pinctrl-single,pins = <
			J721E_IOPAD(0xE8, PIN_INPUT, 8) /* (AG28) PRG0_PRU0_GPO14.UART4_RXD */
		>;
	};

	P9_37B_audio: P9-37B-audio-pins {
		pinctrl-single,pins = <
			J721E_IOPAD(0xE8, PIN_INPUT, 12) /* (AG28) PRG0_PRU0_GPO14.MCASP0_AXR10 */
		>;
	};

	P9_38B_gpio: P9-38B-gpio-pins {
		pinctrl-single,pins = <
			J721E_IOPAD(0xEC, PIN_INPUT, 7) /* (AG27) PRG0_PRU0_GPO15.GPIO0_58 */
		>;
	};

	P9_38B_gpio_pu: P9-38B-gpio-pu-pins {
		pinctrl-single,pins = <
			J721E_IOPAD(0xEC, PIN_INPUT_PULLUP, 7) /* (AG27) PRG0_PRU0_GPO15.GPIO0_58 */
		>;
	};

	P9_38B_gpio_pd: P9-38B-gpio-pd-pins {
		pinctrl-single,pins = <
			J721E_IOPAD(0xEC, PIN_INPUT_PULLDOWN, 7) /* (AG27) PRG0_PRU0_GPO15.GPIO0_58 */
		>;
	};

	P9_38B_uart4_txd: P9-38B-uart4-txd-pins {
		pinctrl-single,pins = <
			J721E_IOPAD(0xEC, PIN_OUTPUT, 8) /* (AG27) PRG0_PRU0_GPO15.UART4_TXD */
		>;
	};

	P9_38B_audio: P9-38B-audio-pins {
		pinctrl-single,pins = <
			J721E_IOPAD(0xEC, PIN_INPUT, 12) /* (AG27) PRG0_PRU0_GPO15.MCASP0_AXR11 */
		>;
	};

	P9_39B_gpio: P9-39B-gpio-pins {
		pinctrl-single,pins = <
			J721E_IOPAD(0xDC, PIN_INPUT, 7) /* (AJ28) PRG0_PRU0_GPO11.GPIO0_54 */
		>;
	};

	P9_39B_gpio_pu: P9-39B-gpio-pu-pins {
		pinctrl-single,pins = <
			J721E_IOPAD(0xDC, PIN_INPUT_PULLUP, 7) /* (AJ28) PRG0_PRU0_GPO11.GPIO0_54 */
		>;
	};

	P9_39B_gpio_pd: P9-39B-gpio-pd-pins {
		pinctrl-single,pins = <
			J721E_IOPAD(0xDC, PIN_INPUT_PULLDOWN, 7) /* (AJ28) PRG0_PRU0_GPO11.GPIO0_54 */
		>;
	};

	P9_39B_audio: P9-39B-audio-pins {
		pinctrl-single,pins = <
			J721E_IOPAD(0xDC, PIN_INPUT, 12) /* (AJ28) PRG0_PRU0_GPO11.MCASP0_AXR7 */
		>;
	};

	P9_40B_gpio: P9-40B-gpio-pins {
		pinctrl-single,pins = <
			J721E_IOPAD(0x148, PIN_INPUT, 7) /* (AA26) PRG0_PRU1_GPO18.GPIO0_81 */
		>;
	};

	P9_40B_gpio_pu: P9-40B-gpio-pu-pins {
		pinctrl-single,pins = <
			J721E_IOPAD(0x148, PIN_INPUT_PULLUP, 7) /* (AA26) PRG0_PRU1_GPO18.GPIO0_81 */
		>;
	};

	P9_40B_gpio_pd: P9-40B-gpio-pd-pins {
		pinctrl-single,pins = <
			J721E_IOPAD(0x148, PIN_INPUT_PULLDOWN, 7) /* (AA26) PRG0_PRU1_GPO18.GPIO0_81 */
		>;
	};

	P9_40B_audio: P9-40B-audio-pins {
		pinctrl-single,pins = <
			J721E_IOPAD(0x148, PIN_INPUT, 12) /* (AA26) PRG0_PRU1_GPO18.MCASP2_AFSX */
		>;
	};

	P9_40B_uart2_rxd: P9-40B-uart2-rxd-pins {
		pinctrl-single,pins = <
			J721E_IOPAD(0x148, PIN_INPUT, 14) /* (AA26) PRG0_PRU1_GPO18.UART2_RXD */
		>;
	};

	P9_41_spi: P9-41-spi-pins {
		pinctrl-single,pins = <
			J721E_IOPAD(0x204, PIN_INPUT, 4) /* (AD5) UART1_RTSn.SPI2_D1 */
		>;
	};

	P9_41_eqep: P9-41-eqep-pins {
		pinctrl-single,pins = <
			J721E_IOPAD(0x204, PIN_INPUT, 5) /* (AD5) UART1_RTSn.EQEP0_I */
		>;
	};

	P9_41_gpio: P9-41-gpio-pins {
		pinctrl-single,pins = <
			J721E_IOPAD(0x204, PIN_INPUT, 7) /* (AD5) UART1_RTSn.GPIO1_0 */
		>;
	};

	P9_41_gpio_pu: P9-41-gpio-pu-pins {
		pinctrl-single,pins = <
			J721E_IOPAD(0x204, PIN_INPUT_PULLUP, 7) /* (AD5) UART1_RTSn.GPIO1_0 */
		>;
	};

	P9_41_gpio_pd: P9-41-gpio-pd-pins {
		pinctrl-single,pins = <
			J721E_IOPAD(0x204, PIN_INPUT_PULLDOWN, 7) /* (AD5) UART1_RTSn.GPIO1_0 */
		>;
	};

	P9_42A_spi: P9-42A-spi-pins {
		pinctrl-single,pins = <
			J721E_IOPAD(0x1F0, PIN_INPUT, 4) /* (AC2) UART0_CTSn.SPI2_CS0 */
		>;
	};

	P9_42A_eqep: P9-42A-eqep-pins {
		pinctrl-single,pins = <
			J721E_IOPAD(0x1F0, PIN_INPUT, 5) /* (AC2) UART0_CTSn.EQEP0_A */
		>;
	};

	P9_42A_gpio: P9-42A-gpio-pins {
		pinctrl-single,pins = <
			J721E_IOPAD(0x1F0, PIN_INPUT, 7) /* (AC2) UART0_CTSn.GPIO0_123 */
		>;
	};

	P9_42A_gpio_pu: P9-42A-gpio-pu-pins {
		pinctrl-single,pins = <
			J721E_IOPAD(0x1F0, PIN_INPUT_PULLUP, 7) /* (AC2) UART0_CTSn.GPIO0_123 */
		>;
	};

	P9_42A_gpio_pd: P9-42A-gpio-pd-pins {
		pinctrl-single,pins = <
			J721E_IOPAD(0x1F0, PIN_INPUT_PULLDOWN, 7) /* (AC2) UART0_CTSn.GPIO0_123 */
		>;
	};

	P9_42B_gpio: P9-42B-gpio-pins {
		pinctrl-single,pins = <
			J721E_IOPAD(0x4C, PIN_INPUT, 7) /* (AJ21) PRG1_PRU0_GPO17.GPIO0_18 */
		>;
	};

	P9_42B_gpio_pu: P9-42B-gpio-pu-pins {
		pinctrl-single,pins = <
			J721E_IOPAD(0x4C, PIN_INPUT_PULLUP, 7) /* (AJ21) PRG1_PRU0_GPO17.GPIO0_18 */
		>;
	};

	P9_42B_gpio_pd: P9-42B-gpio-pd-pins {
		pinctrl-single,pins = <
			J721E_IOPAD(0x4C, PIN_INPUT_PULLDOWN, 7) /* (AJ21) PRG1_PRU0_GPO17.GPIO0_18 */
		>;
	};

	P9_42B_audio: P9-42B-audio-pins {
		pinctrl-single,pins = <
			J721E_IOPAD(0x4C, PIN_INPUT, 12) /* (AJ21) PRG1_PRU0_GPO17.MCASP3_AXR3 */
		>;
	};

};

&wkup_pmx0 {
	P9_33A_gpio: P9-33A-gpio-pins {
		pinctrl-single,pins = <
			J721E_WKUP_IOPAD(0x140, PIN_INPUT, 7) /* (K24) MCU_ADC0_AIN4.WKUP_GPIO0_72 */
		>;
	};

	P9_33A_gpio_pu: P9-33A-gpio-pu-pins {
		pinctrl-single,pins = <
			J721E_WKUP_IOPAD(0x140, PIN_INPUT_PULLUP, 7) /* (K24) MCU_ADC0_AIN4.WKUP_GPIO0_72 */
		>;
	};

	P9_33A_gpio_pd: P9-33A-gpio-pd-pins {
		pinctrl-single,pins = <
			J721E_WKUP_IOPAD(0x140, PIN_INPUT_PULLDOWN, 7) /* (K24) MCU_ADC0_AIN4.WKUP_GPIO0_72 */
		>;
	};

	P9_35A_gpio: P9-35A-gpio-pins {
		pinctrl-single,pins = <
			J721E_WKUP_IOPAD(0x148, PIN_INPUT, 7) /* (K29) MCU_ADC0_AIN6.WKUP_GPIO0_74 */
		>;
	};

	P9_35A_gpio_pu: P9-35A-gpio-pu-pins {
		pinctrl-single,pins = <
			J721E_WKUP_IOPAD(0x148, PIN_INPUT_PULLUP, 7) /* (K29) MCU_ADC0_AIN6.WKUP_GPIO0_74 */
		>;
	};

	P9_35A_gpio_pd: P9-35A-gpio-pd-pins {
		pinctrl-single,pins = <
			J721E_WKUP_IOPAD(0x148, PIN_INPUT_PULLDOWN, 7) /* (K29) MCU_ADC0_AIN6.WKUP_GPIO0_74 */
		>;
	};

	P9_36A_gpio: P9-36A-gpio-pins {
		pinctrl-single,pins = <
			J721E_WKUP_IOPAD(0x144, PIN_INPUT, 7) /* (K27) MCU_ADC0_AIN5.WKUP_GPIO0_73 */
		>;
	};

	P9_36A_gpio_pu: P9-36A-gpio-pu-pins {
		pinctrl-single,pins = <
			J721E_WKUP_IOPAD(0x144, PIN_INPUT_PULLUP, 7) /* (K27) MCU_ADC0_AIN5.WKUP_GPIO0_73 */
		>;
	};

	P9_36A_gpio_pd: P9-36A-gpio-pd-pins {
		pinctrl-single,pins = <
			J721E_WKUP_IOPAD(0x144, PIN_INPUT_PULLDOWN, 7) /* (K27) MCU_ADC0_AIN5.WKUP_GPIO0_73 */
		>;
	};

	P9_37A_gpio: P9-37A-gpio-pins {
		pinctrl-single,pins = <
			J721E_WKUP_IOPAD(0x138, PIN_INPUT, 7) /* (K28) MCU_ADC0_AIN2.WKUP_GPIO0_70 */
		>;
	};

	P9_37A_gpio_pu: P9-37A-gpio-pu-pins {
		pinctrl-single,pins = <
			J721E_WKUP_IOPAD(0x138, PIN_INPUT_PULLUP, 7) /* (K28) MCU_ADC0_AIN2.WKUP_GPIO0_70 */
		>;
	};

	P9_37A_gpio_pd: P9-37A-gpio-pd-pins {
		pinctrl-single,pins = <
			J721E_WKUP_IOPAD(0x138, PIN_INPUT_PULLDOWN, 7) /* (K28) MCU_ADC0_AIN2.WKUP_GPIO0_70 */
		>;
	};

	P9_38A_gpio: P9-38A-gpio-pins {
		pinctrl-single,pins = <
			J721E_WKUP_IOPAD(0x13C, PIN_INPUT, 7) /* (L28) MCU_ADC0_AIN3.WKUP_GPIO0_71 */
		>;
	};

	P9_38A_gpio_pu: P9-38A-gpio-pu-pins {
		pinctrl-single,pins = <
			J721E_WKUP_IOPAD(0x13C, PIN_INPUT_PULLUP, 7) /* (L28) MCU_ADC0_AIN3.WKUP_GPIO0_71 */
		>;
	};

	P9_38A_gpio_pd: P9-38A-gpio-pd-pins {
		pinctrl-single,pins = <
			J721E_WKUP_IOPAD(0x13C, PIN_INPUT_PULLDOWN, 7) /* (L28) MCU_ADC0_AIN3.WKUP_GPIO0_71 */
		>;
	};

	P9_39A_gpio: P9-39A-gpio-pins {
		pinctrl-single,pins = <
			J721E_WKUP_IOPAD(0x130, PIN_INPUT, 7) /* (K25) MCU_ADC0_AIN0.WKUP_GPIO0_68 */
		>;
	};

	P9_39A_gpio_pu: P9-39A-gpio-pu-pins {
		pinctrl-single,pins = <
			J721E_WKUP_IOPAD(0x130, PIN_INPUT_PULLUP, 7) /* (K25) MCU_ADC0_AIN0.WKUP_GPIO0_68 */
		>;
	};

	P9_39A_gpio_pd: P9-39A-gpio-pd-pins {
		pinctrl-single,pins = <
			J721E_WKUP_IOPAD(0x130, PIN_INPUT_PULLDOWN, 7) /* (K25) MCU_ADC0_AIN0.WKUP_GPIO0_68 */
		>;
	};

	P9_40A_gpio: P9-40A-gpio-pins {
		pinctrl-single,pins = <
			J721E_WKUP_IOPAD(0x134, PIN_INPUT, 7) /* (K26) MCU_ADC0_AIN1.WKUP_GPIO0_69 */
		>;
	};

	P9_40A_gpio_pu: P9-40A-gpio-pu-pins {
		pinctrl-single,pins = <
			J721E_WKUP_IOPAD(0x134, PIN_INPUT_PULLUP, 7) /* (K26) MCU_ADC0_AIN1.WKUP_GPIO0_69 */
		>;
	};

	P9_40A_gpio_pd: P9-40A-gpio-pd-pins {
		pinctrl-single,pins = <
			J721E_WKUP_IOPAD(0x134, PIN_INPUT_PULLDOWN, 7) /* (K26) MCU_ADC0_AIN1.WKUP_GPIO0_69 */
		>;
	};

};

