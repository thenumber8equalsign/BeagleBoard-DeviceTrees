// SPDX-License-Identifier: GPL-2.0
/*
 * DT Overlay for w1 gpio23 on BeagleY-AI board.
 *
 * Copyright (C) 2023 Texas Instruments Incorporated - https://www.ti.com/
 *
 */

/dts-v1/;
/plugin/;

#include <dt-bindings/gpio/gpio.h>
#include <dt-bindings/interrupt-controller/irq.h>

/*
 * Helper to show loaded overlays under: /proc/device-tree/chosen/overlays/
 */
&{/chosen} {
	overlays {
		k3-am67a-beagley-ai-w1-gpio23.kernel = __TIMESTAMP__;
	};
};

&{/} {
	onewire {
		status = "okay";
		pinctrl-names = "default";
		pinctrl-0 = <&hat_16_gpio_pu>;

		compatible = "w1-gpio";
		gpios = <&mcu_gpio0 7 GPIO_ACTIVE_HIGH>;
	};
};
