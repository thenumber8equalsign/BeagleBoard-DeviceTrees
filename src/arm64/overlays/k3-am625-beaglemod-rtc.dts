// SPDX-License-Identifier: GPL-2.0
/*
 * Copyright (C) 2022 Texas Instruments Incorporated - https://www.ti.com/
 */

/dts-v1/;
/plugin/;

&main_i2c1 {
	status = "okay";
	#address-cells = <1>;
	#size-cells = <0>;

	pcf8563w@51 {
		compatible = "nxp,pcf8563";
		reg = <0x51>;
		reset-source;
		/* 0 = 4096Hz, 1 = 64Hz, 2 = 1Hz, 3 = 1/60Hz */
		timer-frequency = <0x02>;
		/* Timeout count, max 255 min 2*/
		default-timeout =  <120>;
		min-hw-heartbeat-ms = <2000>;
	};
};
