// SPDX-License-Identifier: GPL-2.0-only OR MIT
/*
 * https://beagleplay.org/
 *
 * Copyright (C) 2022-2024 Texas Instruments Incorporated - https://www.ti.com/
 * Copyright (C) 2022-2024 Robert Nelson, BeagleBoard.org Foundation
 */

#include <dt-bindings/gpio/gpio.h>

/ {
	chosen {
		base_dtb = "k3-am625-beagleplay.dts";
		base_dtb_timestamp = __TIMESTAMP__;
	};
};
